## arch/arm/plat-armada/mv_drivers_lsp/mv_cesa/Kconfig
```kconfig
menu "Cesa options"
	depends on MV_INCLUDE_CESA

config  MV_CESA
	bool "Support for Marvell Cryptographic Engine and Security Acceleration(CESA)"
	default y

config  MV_CESA_TOOL
	bool "Support for Marvell CESA Tool"
	default y
	depends on MV_CESA
	---help---

config MV_CESA_CHANNELS
	int "Total CESA HW channels supported"
        depends on MV_CESA
	range 1 2 if ARCH_ARMADA_XP
	range 1 1 if ARCH_ARMADA370
	default "2" if ARCH_ARMADA_XP
	default "1" if ARCH_ARMADA370
         ---help---
	Select the number of CESA channels to be used for crypto operations acceleration.

choice
	prompt "CESA Features"
	depends on MV_CESA
	default MV_CESA_CHAIN_MODE if (ARCH_ARMADA370 || ARMADA_XP_REV_Z1)
	default MV_CESA_INT_COALESCING_SUPPORT if (ARMADA_XP_REV_A0 || ARMADA_XP_REV_B0)

config MV_CESA_CHAIN_MODE
	bool "Support CESA chain-mode"
        depends on MV_CESA
         ---help---
	Choosing this option will enable CESA chain mode support.

config MV_CESA_INT_COALESCING_SUPPORT
	bool "Support Interrupt Coalescing"
	depends on MV_CESA && (ARMADA_XP_REV_A0 || ARMADA_XP_REV_B0)
	---help---
	Choosing this option will enable CESA interrupt coalescing support.

config MV_CESA_INT_PER_PACKET
	bool "Support interrupt per packet(no optimization)"
	depends on MV_CESA
	---help---
	Choosing this option will enforce CESA to work in interrupt per packet mode.

endchoice

choice 
        prompt "CESA Mode"
        depends on MV_CESA
        default MV_CESA_OCF

config	MV_CESA_OCF
	tristate "Support for Marvell CESA OCF driver"
	depends on OCF_OCF
	---help---
	  Choosing this option will enable you to use the Marvell Cryptographic Engine and
	  Security Accelerator, under the OCF package.

config  MV_CESA_TEST
	bool "Support for Marvell CESA test driver"
	depends on MV_CESA_TOOL 
	---help---
	  Choosing this option will enable you to use the Marvell Cryptographic Engine and
	  Security Accelerator, with the mv_cesa_tool in test mode.

endchoice

endmenu
```

## arch/arm/plat-armada/mv_drivers_lsp/mv_phone/Kconfig
```kconfig
menu "Telephony options"
	depends on MV_INCLUDE_TDM

config  MV_PHONE
	bool "Support for Marvell telephony(VoIP)"
	depends on MV_INCLUDE_TDM && PHONE
	default y
	---help---
	  Choosing this option enables the Marvell telephony underlying
	  support for various VoIP applications.
	  Note, kernel Telephony subsystem must be chosen too.

choice
	prompt "TDM Unit"
	depends on MV_PHONE
	default MV_TDM_SUPPORT_ARMADA

config MV_TDM_SUPPORT_ARMADA
	bool "Support legacy TDM(2 channels)"
	select MV_TDM_SUPPORT

config MV_COMM_UNIT_SUPPORT_ARMADA
	depends on ARCH_FEROCEON_KW2 || ARCH_ARMADA_XP
	bool "Support CommUnit(up to 32 channels)"
	select MV_COMM_UNIT_SUPPORT

endchoice

config MV_TDM_SUPPORT
	depends on MV_TDM_SUPPORT_ARMADA
	bool

config MV_COMM_UNIT_SUPPORT
	depends on MV_COMM_UNIT_SUPPORT_ARMADA
	bool

choice
	prompt "SLIC Vendor"
	depends on MV_PHONE
	default ZARLINK_SLIC_SUPPORT_ARMADA

#config SILABS_SLIC_SUPPORT_ARMADA
#	bool "Support Silicon Labs devices"
#	select SILABS_SLIC_SUPPORT

config ZARLINK_SLIC_SUPPORT_ARMADA
	bool "Support Zarlink/Legirity devices"
	select ZARLINK_SLIC_SUPPORT

endchoice

#config SILABS_SLIC_SUPPORT
#	depends on SILABS_SLIC_SUPPORT_ARMADA
#	bool

config ZARLINK_SLIC_SUPPORT
	depends on ZARLINK_SLIC_SUPPORT_ARMADA
	bool

choice
	prompt "SLIC Device"
	depends on MV_PHONE && SILABS_SLIC_SUPPORT

config SILABS_SLIC_3215
	bool "Support Silicon Labs 3215 device"

config SILABS_SLIC_3217
	bool "Support Silicon Labs 3217 device"

endchoice

choice
	prompt "SLIC Device"
	depends on MV_PHONE && ZARLINK_SLIC_SUPPORT
	default ZARLINK_SLIC_VE880_ARMADA

config ZARLINK_SLIC_VE880_ARMADA
	bool "Support Zarlink VE880 SLIC family"
	select ZARLINK_SLIC_VE880

config ZARLINK_SLIC_VE792_ARMADA
	bool "Support Zarlink VE792 SLIC family"
	select ZARLINK_SLIC_VE792

endchoice

config ZARLINK_SLIC_VE880
	depends on ZARLINK_SLIC_VE880_ARMADA
	bool

config ZARLINK_SLIC_VE792
	depends on ZARLINK_SLIC_VE792_ARMADA
	bool

choice
	prompt "PCM Clock Frequency"
	depends on MV_PHONE
	default MV_TDM_PCM_CLK_8MHZ_ARMADA
	---help---
	This menu selects the PCM clock frequency generated by the TDM master.
	SLIC should be configured accordingly in order to maintain bus coherency.

config MV_TDM_PCM_CLK_8MHZ_ARMADA
	bool "Support 8MHz PCM clock"
	select MV_TDM_PCM_CLK_8MHZ

config MV_TDM_PCM_CLK_4MHZ_ARMADA
	bool "Support 4MHz PCM clock"
	select MV_TDM_PCM_CLK_4MHZ

config MV_TDM_PCM_CLK_2MHZ_ARMADA
	bool "Support 2MHz PCM clock"
	select MV_TDM_PCM_CLK_2MHZ

endchoice

config MV_TDM_PCM_CLK_8MHZ
	depends on MV_TDM_PCM_CLK_8MHZ_ARMADA
	bool

config MV_TDM_PCM_CLK_4MHZ
	depends on MV_TDM_PCM_CLK_4MHZ_ARMADA
	bool

config MV_TDM_PCM_CLK_2MHZ
	depends on MV_TDM_PCM_CLK_2MHZ_ARMADA
	bool

choice
	prompt "TDM voice processing"
	depends on MV_PHONE
	default MV_TDM_DUMMY_ARMADA

config MV_TDM_DUMMY_ARMADA
	bool "Support TDM voice processing in softIRQ"
	select MV_TDM_DUMMY

config MV_PHONE_USE_IRQ_PROCESSING_ARMADA
	bool "Support Rx/Tx processing in interrupt context"
	depends on MV_PHONE
	select MV_PHONE_USE_IRQ_PROCESSING
	---help---
	Choosing this option supports Rx/Tx voice processing in interrupt context, otherwise
	processing is performed in tasklet context.

endchoice

config MV_TDM_DUMMY
	depends on MV_TDM_DUMMY_ARMADA
	bool

config MV_PHONE_USE_IRQ_PROCESSING
	depends on MV_PHONE_USE_IRQ_PROCESSING_ARMADA
	bool

config MV_TDM_USE_EXTERNAL_PCLK_SOURCE
	bool "Support PCLK from external source"
	depends on MV_PHONE
	default n
	---help---
	Choosing this option enables TDM unit to use PCLK supplied by external source.

config MV_PHONE_USE_SLIC_LIBS
	bool "Use binary SLIC drivers"
	depends on MV_PHONE
	default y
	---help---
	Unselect this option only if you have source code of SLIC drivers.
	If unsure, say "y"

endmenu
```

## arch/arm/plat-armada/mv_drivers_lsp/mv_pon/Kconfig
```kconfig
menu "SoC PON support"
depends on MV_INCLUDE_PON

config MV_GPON_TCONTS
        int "GPON T-CONT's number"
        default 8 
        ---help---

choice
	prompt "PON Driver mode"
	default MV_GPON

config  MV_GPON
	tristate "Support for Marvell GPON Driver"
        select CONFIG_MV_GPON_MODULE

config  MV_EPON
	tristate "Support for Marvell EPON Driver"
        select CONFIG_MV_EPON_MODULE

endchoice

comment "GPON Driver Options"
depends on MV_GPON

config  MV_GPON_HW_INTERRUPT
	bool "Support for GPON HW Interrupt"
	depends on MV_GPON
      	default y
	---help---

config  MV_GPON_DEBUG_PRINT
	bool "Support for GPON Debug printing"
	depends on MV_GPON
      	default y
	---help---

config  MV_GPON_STATIC_GEM_PORT
	bool "Support for static GPON Gem Port"
	depends on MV_GPON
      	default y
	---help---

config  MV_GPON_PERFORMANCE_CHECK
	bool "Support for GPON Performance Validation"
	depends on MV_GPON
      	default n
	---help---

comment "EPON Driver Options"
depends on MV_EPON

config  MV_EPON_HW_INTERRUPT
	bool "Support for EPON HW Interrupt"
	depends on MV_EPON
      	default y
	---help---

config MV_EPON_SINGLE_MAC
	bool "EPON with single MAC"
        depends on MV_EPON
        default y
        ---help---

config MV_EPON_MAC
	int "EPON LLID's number"
        depends on MV_EPON
        default 1
        ---help---

endmenu
```
