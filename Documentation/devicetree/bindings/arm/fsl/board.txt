## arch/arm/mach-hi3536slave/Kconfig
```kconfig
menu "Hi3536 board feature"

config MACH_HI3536
	bool "Support hi3536 platform"
	select CPU_V7
	select ARM_GIC
	select ARM_TIMER_SP804
	help
	  Include support for the hisilion Hi3536 platform.
	  Hi3536 support ARM CORTEX-A7 processer,
	  within a Generic Interrupt Controller.
	  Support DDR2 and DDR3.

choice
	prompt "CPU timer source"
	default SP804_LOCAL_TIMER

config SP804_LOCAL_TIMER_SLAVE
	bool "arm local timer from sp804 for slave"
	help
	  arm local timer from sp804.
	  if you choice sp804 as local timer,
	  please select HAVE_SP804_LOCAL_TIMER_HI3536,
	  if you choice arm selt as local timer,
	  please select HAVE_ARM_LOCAL_TIMER.

config ARM_LOCAL_TIMER_SLAVE
	bool "arm local timer from arm self for slave"
	help
	  arm local timer from arm self.
	  if you choice sp804 as local timer,
	  please select HAVE_SP804_LOCAL_TIMER_HI3516A,
	  if you choice arm selt as local timer,
	  please select HAVE_ARM_LOCAL_TIMER.

endchoice

config HI_3536_HZ
	int "Config HZ"
	default 100 if HIGH_RES_TIMERS
	default 100

config DEFAULT_BUSCLK
	int "DEFAULT_BUSCLK"
	default "50000000"
	help
	  Default AHB clock rate

config DEFAULT_UART_BASE_ADDR
	hex "Default uart controller base address"
	default "0xF8B00000"
	help
	  Default UART controller base address

endmenu
```
