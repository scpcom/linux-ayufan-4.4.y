## arch/arm/mach-armadaxp/Kconfig
```kconfig
if ARCH_ARMADA_XP

config  MV_HAL_RULES_PATH
        string "path of the mvRules.mk file for HAL drivers"
        default "arch/arm/mach-armadaxp/mv_hal_support/mvRules.mk"
        ---help---
	
#source "arch/arm/plat-orion/mv_hal_drivers/Kconfig"

menu "Marvell Armada Options"

config ARMADA_XP
	bool "Armada XP SoC Family"
	default y

choice
	prompt "Armada XP Chip revision"
	depends on ARMADA_XP
	default ARMADA_XP_REV_B0

config  ARMADA_XP_REV_Z1
	bool "MV88F78x30 and MV88F78x60 Z1 SoC devices"
	select ARMADA_XP_ERRATA_SMI_1
#	select ARMADA_XP_DEEP_IDLE_L2_WA if CACHE_AURORA_L2
#	select ARMADA_XP_DEEP_IDLE_UNMASK_INTS_WA
	select SHEEVA_ERRATA_ARM_CPU_4742
	select SHEEVA_ERRATA_ARM_CPU_4786 if (ARM_THUMB && VFP)
#	select SHEEVA_ERRATA_ARM_CPU_5315
	select SHEEVA_ERRATA_ARM_CPU_4413
	select SHEEVA_ERRATA_ARM_CPU_4659
	select SHEEVA_ERRATA_ARM_CPU_5114 if (CPU_SHEEVA_PJ4B_V6 && AURORA_IO_CACHE_COHERENCY)
	select SHEEVA_ERRATA_ARM_CPU_4611
#	select SHEEVA_ERRATA_ARM_CPU_4948
	select SHEEVA_ERRATA_ARM_CPU_PMU_RESET
	select SHEEVA_ERRATA_ARM_CPU_BTS61 if (SMP || AURORA_IO_CACHE_COHERENCY)
	---help---
	Choosing this option will generate a linux kernel for the
	  MV78x30 and MV78x60 devices with revision Z1

config  ARMADA_XP_REV_A0
	bool "MV88F78x30 and MV88F78x60 A0 SoC devices"
	---help---
	Choosing this option will generate a linux kernel for the
	  MV78x30 and MV78x60 devices with revision A0

config  ARMADA_XP_REV_B0
	bool "MV88F78x30 and MV88F78x60 B0 SoC devices"
	---help---
	Choosing this option will generate a linux kernel for the
	  MV78x30 and MV78x60 devices with revision B0

endchoice

config  ARMADA_XP_A0_WITH_B0
	bool "Armada XP A0 and B0 Runtime Support"
	default n
	depends on ARMADA_XP_REV_B0
	---help---
	Choosing this option will generate a linux kernel supporting both A0 and B0 revisions
	Selection is done at runtime based on silicon revision.
	Due to performance impact, it is recommended to disable this option in case of B0 only.


config MACH_ARMADA_XP_DB
	bool "Marvell Armada XP Development Board"	
	default y
	help

config MACH_ARMADA_XP_GP
	bool "Marvell Armada XP General Purpose Board"
	default y
	help

config MACH_ARMADA_XP_RDSRV
	bool "Marvell Armada XP Server Board"
	default y
	help

config MACH_ARMADA_XP_RD_NAS
	bool "Marvell Armada XP NAS RD Board"
	default y
	help

config MACH_ARMADA_XP_FPGA
	bool "Marvell Armada XP FPGA Board"	
	depends on !MACH_ARMADA_XP_DB && !MACH_ARMADA_XP_RDSRV
	default y
	help

config CFU_DRAM_BYPASS
        bool "Bypass CFU to DRAM via Punit"
	default n
	help

config ARMADA_XP_SPARSEMEM
	bool "Use sparse memory model"
	select ARCH_SPARSEMEM_ENABLE
	default n

config ARMADAXP_USE_IRQ_INTERRUPT_ACK
       bool "Use Interrupt Ack register to detect pending interrupts"
       default n
       help

config ARMADA_XP_BTNS_DEVICE
	bool "Add support for ArmadaXP buttons driver for GPIOs"
	default n
	help

endmenu

endif
```

## arch/arm/mach-comcerto/Kconfig
```kconfig
if ARCH_COMCERTO

menu "Comcerto Implementation Options"

config ARCH_SUPPORTS_BIG_ENDIAN
	bool "Architecture supports Big Endian"
        default n

choice
	prompt "Comcerto System Type"
	default CONFIG_ARCH_M86XXX

config ARCH_M86XXX
	bool "M86xxx"
	select CPU_V7
	select ARM_GIC
	select ARM_GIC_V2M
	select ARM_ERRATA_743622
	select ARM_ERRATA_751472
	select ARM_ERRATA_754322
	select ARM_ERRATA_764369 if SMP
	select MTD_COMCERTO_NOR
	select COMCERTO_UART1_SUPPORT
#	select COMCERTO_PFE_UART_SUPPORT
	select COMCERTO_USB2_SUPPORT
	select COMCERTO_USB3_SUPPORT
# 	select COMCERTO_USB3_INTERNAL_CLK
#	select COMCERTO_IPSEC_SUPPORT
	select COMCERTO_I2C_SUPPORT
	select GENERIC_TIME
	select GENERIC_CLOCKEVENTS
	select HAVE_SCHED_CLOCK
#	select COMCERTO_DW_DMA_SUPPORT
	select CLKDEV_LOOKUP
#	select ARCH_HAS_CPUFREQ
	select ARCH_HAS_OPP
	select MIGHT_HAVE_PCI if !RTSM_C2K
	select PCI_MSI if PCI
	select HAVE_SMP
	select MIGHT_HAVE_CACHE_L2X0
	select HAVE_ARM_TWD
	select HAVE_ARM_SCU
	select HOTPLUG
	select GENERIC_IRQ_LEGACY
	help
	  Say Y here if you intend to run this kernel with a Comcerto2000 device.

endchoice



choice
	prompt "Comcerto Board type"
	default RTSM_C2K

config C2K_EVM
	bool "EVM"
	depends on ARCH_M86XXX
	help
	  Say Y here if you intend to run this kernel with a C2K EVM.

config C2K_MFCN_EVM
	bool "MFCN EVM"
	depends on ARCH_M86XXX
	help
	  Say Y here if you intend to run this kernel with a C2K MFCN EVM.

config C2K_ASIC
	bool "ASIC"
	depends on ARCH_M86XXX
	select COMCERTO_UART0_SUPPORT
	help
	  Say Y here if you intend to run this kernel with a C2K ASIC.

config RTSM_C2K
	bool "RTSM"
	depends on ARCH_M86XXX
	help
	  Say Y here if you intend to run this kernel with a C2K RTSM.

endchoice


config MTD_COMCERTO_NOR
	bool
	default y

config COMCERTO_EXP_BUS_LOCK
        bool "Comcerto expansion bus locking mechanism to synchronize expansion bus access"
	default y
	help
	  Say Y if you intend to use the comcerto expansion bus locking mechanism to synchronise access between
	  devices that share expansion bus. Currently available for NOR and NAND flashes.

config COMCERTO_TDM_CLOCK
        bool "Comcerto device TDM clock and frame sync control through sysfs"
	default y
	help
	  Say Y if you intend to use the Comcerto TDM and be able to change
	  different parameters through sysfs.

config COMCERTO_CSYS_TPI_CLOCK
        bool "Comcerto device TPI and CSYS clock control "
	default n
	help
	  Say Y if you intend to use the Comcerto TPI (Cortex A9 JTAG interface) and CSYS clock (Cortex A9 CoreSight module).

config COMCERTO_PCIE_OCC_CLOCK
        bool "Comcerto device PCIE OCC clock control "
	default n
	help
	  Say Y if you intend to use the Comcerto PCIE OCC clock.

config COMCERTO_SATA_OCC_CLOCK
        bool "Comcerto device SATA OCC clock control "
	default n
	help
	  Say Y if you intend to use the Comcerto SATA OCC clock.

config COMCERTO_SGMII_OCC_CLOCK
        bool "Comcerto device SGMII OCC clock control "
	default n
	help
	  Say Y if you intend to use the Comcerto SGMII OCC clock.

config COMCERTO_MEMBUF
	bool "Comcerto memory buffer driver"
	default n
	help
	  Say Y if you intend to use the memory buffer driver. This driver helps
	  Linux user space applications setup a physical scatter buffer that can be used
	  directly by the PFE. Currently the PFE hold tone generation feature requires
	  this driver to be enabled.

config COMCERTO_NUM_PCIES
	int "Number of PCIe controllers to be enabled (0-2)"
	range 0 2
	depends on ARCH_M86XXX 
	default "2"

config COMCERTO_NAS
	bool "Comcerto NAS Support"
	depends on ARCH_M86XXX
	default n
	select COMCERTO_SATA
	select COMCERTO_EXT4_WRITEBACK_BUMP
	help
	  Say Y here to enable several features and optimizations that improve system performance
	  when using a NAS configuration.

config COMCERTO_UART0_SUPPORT
	bool
	default n

config COMCERTO_UART1_SUPPORT
	bool
	default y

config COMCERTO_USB2_SUPPORT
	bool
	default n

config COMCERTO_USB3_SUPPORT
	bool
	default n

config COMCERTO_IPSEC_SUPPORT
	bool
	default n

config COMCERTO_EPAVIS
	bool "DPI EPAVIS content inspection driver"
	default n

config COMCERTO_ELP_SUPPORT
	bool "Elliptic EPN1802 SPAcc/PKA crypto driver"
	default y

config COMCERTO_I2C_SUPPORT
        bool
        default n

config COMCERTO_DW_DMA_SUPPORT
        bool
        default n

config COMCERTO_DDR_ECC_SUPPORT
        bool "Fix for the Comcerto DDR ECC Support problem"
        default n
        help
          There is a limitation with Denali DDRC Controller when ECC is enabled. It expects that the
          burst writes of greater than or equal to 16 bytes must start and end at a 16-byte boundary.
          Saying Y for this option will make the dma memory area to be non-writeable, apart from being
          non-cacheable so that single write should happen instead of burst.

config COMCERTO_SATA
	bool "Comcerto SATA"
	select ATA
	select ATA_VERBOSE_ERROR
	select SATA_AHCI_PLATFORM
	select BLK_DEV_SD
	select LBDAF

config DSPG_DECT_CSS
	bool "DSPG DECT CSS"
	default n

config COMCERTO_USB3_INTERNAL_CLK
	bool "Comcerto internal clock for USB3"
	default n

config COMCERTO_AHCI_PROF
	bool "Comcerto AHCI profiling"
	bool
	default n

config COMCERTO_MDMA_PROF
	bool "Comcerto MDMA profiling"
	depends on COMCERTO_DMA_BASIC
	default n

config COMCERTO_CC_OPTIMIZE_O3
	bool "Compile the kernel with -O3"
	default n
	depends on !CC_OPTIMIZE_FOR_SIZE
	help
	  Compile the kernel with -O3 instead of -O2 option. Resulting kernel can be a bit faster, but
	  it will also be bigger.

config COMCERTO_HW_KERNEL_PAGETABLE
	bool "Use the 2nd HW page table for kernel memory space"
	select VMSPLIT_2G
	default n
	help
	  By default, Linux uses only one page table at a time, and switches page tables when switching
	  between processes. Say Y to enable the 2nd hardware page table, which will be used to map kernel
	  addresses.
	  Note that because of the way the ARM MMU determines which page table to use, this option can
	  only be enabled with a 2G/2G userspace/kernel memory split.

config COMCERTO_UNCACHED_DMA
	bool "Make pages uncacheable when doing DMA operations"
	depends on COMCERTO_HW_KERNEL_PAGETABLE
	default n
	help
	  When transferring ownership of a page to a device through the DMA API, make the page uncacheable
	  for the duration of the transfer. This makes the 2nd cache invalidate (that was needed because
	  of the possibility of speculative accesses by the A9 cores) unnecessary, which can increase
	  performance during heavy IO workloads. The page tables will be more complex though, resulting in
	  more TLB misses when a DMA transfer is going on.

config COMCERTO_EXT4_WRITEBACK_BUMP
	bool
	default n
endmenu

source "drivers/pci/hotplug/Kconfig"
endif
```

## arch/arm/mach-feroceon-kw/Kconfig
```kconfig
if ARCH_FEROCEON_KW

choice
	prompt "Feroceon-KW SoC type"
	default MV88F6281

config  MV88F6281
	bool "88F6281/88F6192/88F6190/88F6180/ SoC"
	---help---
	Choosing this option will generate a linux kernel for the 88F6281/88F6192/88F6190/88F6180 SoC

endchoice

config SYNO_MV88F6281
	bool "Support for Synology MV6281 Board"
	select MACH_SYNOLOGY_6282
	---help---
	Choosing this option will generate a linux kernel for the Synology board

config MACH_SYNOLOGY_6282
	bool "Support for Synology 6282 series Board"
	default n

config SYNO_MV88F6281_USBSTATION
	bool "Support for Synology USBStation 2"
	---help---
	Choosing this option will generate a linux kernel for the Synology board

endif
```

## arch/arm/mach-hi3521a/Kconfig
```kconfig
menu "Hi3521a board feature"

config MACH_HI3521A
	bool "Support hi3521a platform"
	select CPU_V7
	select ARM_GIC
	select ARM_TIMER_SP804
	help
	  Include support for the hisilion Hi3521A platform.
	  Hi3521A support ARM CORTEX-A7 processer,
	  within a Generic Interrupt Controller.
	  Support DDR2 and DDR3.
choice
	prompt "CPU timer source"
	default SP804_LOCAL_TIMER_HI3521A

config SP804_LOCAL_TIMER_HI3521A
	bool "arm local timer from sp804"
	help
	  arm local timer from sp804.
	  if you choice sp804 as local timer,
	  please select HAVE_SP804_LOCAL_TIMER_HI3521A,
	  if you choice arm selt as local timer,
	  please select HAVE_ARM_LOCAL_TIMER_HI3521A.

config ARM_LOCAL_TIMER_HI3521A
	bool "arm local timer from arm self"
	help
	  arm local timer from arm self.
	  if you choice sp804 as local timer,
	  please select HAVE_SP804_LOCAL_TIMER_HI3521A,
	  if you choice arm selt as local timer,
	  please select HAVE_ARM_LOCAL_TIMER_HI3521A.

endchoice

config HI_3521A_HZ
	int "Config HZ"
	default 100 if HIGH_RES_TIMERS
	default 100

config DEFAULT_BUSCLK
	int "DEFAULT_BUSCLK"
	default "50000000"
	help
	  Default AHB clock rate

config DEFAULT_UART_BASE_ADDR
	hex "Default uart controller base address"
	default "0x12080000"
	help
	  Default UART controller base address

endmenu
```

## arch/arm/mach-hi3531a/Kconfig
```kconfig
menu "Hi3531a board feature"

config MACH_HI3531A
	bool "Support hi3531a platform"
	select CPU_V7
	select ARM_GIC
	select ARM_TIMER_SP804
	help
	  Include support for the hisilion Hi3531A platform.
	  Hi3531a support ARM CORTEX-A9 processer,
	  within a Generic Interrupt Controller.
	  Support DDR2 and DDR3.
choice
	prompt "CPU timer source"
	default SP804_LOCAL_TIMER_HI3531A

config SP804_LOCAL_TIMER_HI3531A
	bool "arm local timer from sp804"
	help
	  arm local timer from sp804.
	  if you choice sp804 as local timer,
	  please select HAVE_SP804_LOCAL_TIMER_HI3531A,
	  if you choice arm selt as local timer,
	  please select HAVE_ARM_LOCAL_TIMER_HI3531A.

config ARM_LOCAL_TIMER_HI3531A
	bool "arm local timer from arm self"
	help
	  arm local timer from arm self.
	  if you choice sp804 as local timer,
	  please select HAVE_SP804_LOCAL_TIMER_HI3531A,
	  if you choice arm selt as local timer,
	  please select HAVE_ARM_LOCAL_TIMER_HI3531A.

endchoice

config HI_3531A_HZ
	int "Config HZ"
	default 100 if HIGH_RES_TIMERS
	default 100

config DEFAULT_BUSCLK
	int "DEFAULT_BUSCLK"
	default "50000000"
	help
	  Default AHB clock rate

config DEFAULT_UART_BASE_ADDR
	hex "Default uart controller base address"
	default "0x12080000"
	help
	  Default UART controller base address

endmenu
```

## arch/arm/mach-hi3536/Kconfig
```kconfig
menu "Hi3536 board feature"

config MACH_HI3536
	bool "Support hi3536 platform"
	select CPU_V7
	select ARM_GIC
	select ARM_TIMER_SP804
	help
	  Include support for the hisilion Hi3536 platform.
	  S40 support ARM CORTEX-A17 processer,
	  within a Generic Interrupt Controller.
	  Support DDR2 and DDR3.

choice
	prompt "CPU timer source"
	default SP804_LOCAL_TIMER

config SP804_LOCAL_TIMER
	bool "arm local timer from sp804"
	help
	  arm local timer from sp804.
	  if you choice sp804 as local timer,
	  please select HAVE_SP804_LOCAL_TIMER_HI3536,
	  if you choice arm selt as local timer,
	  please select HAVE_ARM_LOCAL_TIMER.

config ARM_LOCAL_TIMER
	bool "arm local timer from arm self"
	help
	  arm local timer from arm self.
	  if you choice sp804 as local timer,
	  please select HAVE_SP804_LOCAL_TIMER_HI3516A,
	  if you choice arm selt as local timer,
	  please select HAVE_ARM_LOCAL_TIMER.

endchoice

config HI_3536_HZ
	int "Config HZ"
	default 100 if HIGH_RES_TIMERS
	default 100

config DEFAULT_BUSCLK
	int "DEFAULT_BUSCLK"
	default "50000000"
	help
	  Default AHB clock rate

config DEFAULT_UART_BASE_ADDR
	hex "Default uart controller base address"
	default "0xF8B00000"
	help
	  Default UART controller base address

config HI3536_SYSCNT
	bool "hi3536 syscounter"
	depends on MACH_HI3536
	default n if MACH_HI3536
	help
	  This is the parameter about syscounter.
	  When it is set,syscounter is enabled.
	  The parameter should be fit to logic
	  version.

config A17_BOOT_A7
	bool "A17 booting A7"
	depends on ARCH_HI3536
	default y if ARCH_HI3536
	help
	  A17 boot A7 up.
	  when this parameter set true,
	  A17 os will boot A7 os.
	  This parameter is used in A17 os.

config HI3536_TAG
	hex "hi3536 tag"
	depends on A17_BOOT_A7
	default "0x726d6d80"
	help
	  Parameters passed from uboot can be parseed via this tag.

config IRQNUM_SEND_TO_A7
	int "the num of irq sending to A7"
	range 2 1020
	depends on A17_BOOT_A7
	default 20 if ARCH_HI3536
	help
	 It shows how many irqs should send to A7 in A17-booting-A7 mode.

config IRQ_TO_A7
	string "Send irq to A7"
	depends on A17_BOOT_A7
	default "34,39,106"  if ARCH_HI3536
	help
          when A17 booting A7,some irq should send to A7 cpu.This parameter shows
          which irq should pass to A7 cpu.The irq num should be in the range (32 1020).
          This is done here because gic distributor is inited here.

endmenu
```
