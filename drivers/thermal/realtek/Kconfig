## drivers/thermal/realtek/Kconfig
```kconfig
config RTK_THERMAL
	bool "Realtek thermal management"
	depends on (OF && SYNO_LSP_RTD129X) || (OF && THERMAL_OF && SYNO_LSP_RTD1619)
	default y if SYNO_LSP_RTD129X
	help
	  Enable thermal management with a generic thermal
	  sensor driver on Realtek SoCs.

	  If you want this support, you should say Y here.

if SYNO_LSP_RTD129X
config RTK_THERMAL_CPU_CORE_COOLING
    tristate "Realtek cpu_core cooling"
    depends on RTK_THERMAL && HOTPLUG_CPU
    default y
endif # SYNO_LSP_RTD129X

if SYNO_LSP_RTD1619
config RTK_THERMAL_EOH
	bool "Realtek thermal sensor EOH"
	depends on RTK_THERMAL

config RTK_THERMAL_RTD119X
	bool "RTD-119X thermal sensor support"
	depends on ARCH_RTD119X
	default y
	select RTK_THERMAL

config RTK_THERMAL_RTD129X
	bool "RTD-129x thermal sensor support"
	depends on ARCH_RTD129x
	default y
	select RTK_THERMAL

config RTK_THERMAL_RTD139X
	bool "RTD-139x thermal sensor support"
	depends on ARCH_RTD139x
	default y
	select RTK_THERMAL

config RTK_THERMAL_RTD16XX
	bool "RTD-16XX thermal sensor support"
	depends on ARCH_RTD16xx
	default y
	select RTK_THERMAL

config RTK_THERMAL_RTD13XX
	bool "RTD-13XX thermal sensor support"
	depends on ARCH_RTD13xx
	default y
	select RTK_THERMAL
endif # SYNO_LSP_RTD1619
```

## drivers/usb/host/Kconfig.hi3531A
```kconfig
#
# hiusb Host Controller Drivers
#
comment "hiusb Host Controller Drivers"
	depends on USB

menuconfig HIUSB_HOST
	bool "hiusb(xhci/ehci/ohci) family usb host device support"
	default y
	help
	  This selects the usb(xhci/ehci/ohci) family usb host device.
	  Say Y to init hisi usb2.0 ehci ohci and usb3.0 xhci controller and
	  phy. But you only also init the hisi controller and phy, you should
	  add the ehci_hcd.ko ohci_hcd.ko and xhci_hcd.ko.

if HIUSB_HOST

config HIUSB_XHCI
	bool "hiusb-xhci usb host device support"
	default y

config HIUSB_XHCI_IOBASE
	hex "hiusb-xhci IO address"
	default "0x11000000"

config HIUSB_XHCI_IOSIZE
	hex "hiusb-xhci IO size"
	default "0x00010000"
	help
	  default is 0x10000.

config HIUSB_XHCI_IRQNUM
	int "hiusb-xhci irq number"
	default "54"

config HIUSB_EHCI
	bool "hiusb-ehci usb host device support"
	default y

config HIUSB_EHCI_IOBASE
	hex "hiusb-ehci IO address"
	default "0x100C0000"

config HIUSB_EHCI_IOSIZE
	hex "hiusb-ehci IO size"
	default "0x00010000"

config HIUSB_EHCI_IRQNUM
	int "hiusb-ehci irq number"
	default "51"

config HIUSB_OHCI
	bool "hiusb-ohci usb host device support"
	default y

config HIUSB_OHCI_IOBASE
	hex "hiusb-ohci IO address"
	default "0x100B0000"

config HIUSB_OHCI_IOSIZE
	hex "hiusb-ohci IO size"
	default "0x00010000"

config HIUSB_OHCI_IRQNUM
	int "hiusb-ohci irq number"
	default "50"
endif # HIUSB_HOST2_0

menuconfig HIUSB_DEVICE2_0
	bool "hiusb2.0 usb device support"
	default y
	select USB_GADGET_DUALSPEED
	select USB_GADGET_SELECTED
	help
          This selects the usb(ehci/ohci) family usb device.
	  Say Y to enable hisi usb2.0 controller driver.
	  IF you do not use usb2.0 device in your board,
	  say N to get a smaller uImage. Mostly you need it.

if HIUSB_DEVICE2_0

config HIUSB_DEVICE
	tristate "hisilicon highspeed device controller version 3.00a driver"
	default y
	help
	  You can select device mode by the option.
	  Enable hisi ehci controller driver.
	  Say Y to enable hisi usb2.0 ehci controller driver.
	  IF you do not use usb2.0 ehci device in your board, say N to get a
	  smaller uImage. Mostly you need it.

config HIUSBUDC_REG_BASE_ADDRESS
	hex "hisilicon highspeed device control register base address"
	default "0x100c0000" if ARCH_HI3531A

config HIUSBUDC_REG_BASE_ADDRESS_LEN
	hex "hisilicon highspeed device control register size length"
	default "0x40000" if ARCH_HI3531A

config HIUSBUDC_IRQ_NUMBER
	int "hisilicon highspeed device interrupt number"
	default "54" if ARCH_HI3531A

config HIUSBUDC_DMA_BUF_LENGTH
	int "hisilicon highspeed device dma buffer length"
	default "16384" if ARCH_HI3531A

config HIUSBUDC_PHY_UTMI_BITWIDTH
	int "hisilicon highspeed device phy interface utmi bitwidth"
	default "8"

config HIUSB_SWITCH_HOST_DEVICE
	hex "host/device switch register address"
	default "0x12120090" if ARCH_HI3531A
	help
	  host/device switch register address. You config the
	  register, you can switch the board status. The status
	  is host or device. At the same time, the board is only
	  one status.

config SWITCH_HIUSB_HOST_DEVICE_BIT
	int "host/device switch set bit"
	default "31"

config HIUSB_OTG_SWITCH_TIME
	int "host/device detection interval(ms)"
	default "1000"
	help
	  host/device detection interval. We default is 1s.
	  You can change the value according to your actual
	  situation.
endif # HI_HS_DEVICE
```

## drivers/usb/host/Kconfig.hi3536
```kconfig
#
# hiusb Host Controller Drivers
#
comment "hiusb Host Controller Drivers"
	depends on USB

menuconfig HIUSB_HOST
	bool "hiusb(xhci/ehci/ohci) family usb host device support"
	default y
	help
	  This selects the usb(xhci/ehci/ohci) family usb host device.

if HIUSB_HOST

config HIUSB_XHCI
	bool "hiusb-xhci usb host device support"
	default y

config HIUSB_XHCI_IOBASE
	hex "hiusb-xhci IO address"
	default "0x11040000"

config HIUSB_XHCI_IOSIZE
	hex "hiusb-xhci IO size"
	default "0x00010000"
	help
	  default is 0x10000.

config HIUSB_XHCI_IRQNUM
	int "hiusb-xhci irq number"
	default "60"

config HIUSB_EHCI
	bool "hiusb-ehci usb host device support"
	default y

config HIUSB_EHCI_IOBASE
	hex "hiusb-ehci IO address"
	default "0x10040000"

config HIUSB_EHCI_IOSIZE
	hex "hiusb-ehci IO size"
	default "0x00010000"
	help
	  default is 0x10000.

config HIUSB_EHCI_IRQNUM
	int "hiusb-ehci irq number"
	default "53"

config HIUSB_OHCI
	bool "hiusb-ohci usb host device support"
	default y

config HIUSB_OHCI_IOBASE
	hex "hiusb-ohci IO address"
	default "0x10030000"

config HIUSB_OHCI_IOSIZE
	hex "hiusb-ohci IO size"
	default "0x00010000"
	help
	  default is 0x10000.

config HIUSB_OHCI_IRQNUM
	int "hiusb-ohci irq number"
	default "52"
endif # HIUSB_HOST2_0

menuconfig HIUSB_DEVICE2_0
	bool "hiusb2.0 usb device support"
	default y
	select USB_GADGET_DUALSPEED
	select USB_GADGET_SELECTED
	help
          This selects the usb(ehci/ohci) family usb device.
	  Say Y to enable hisi usb2.0 controller driver.
	  IF you do not use usb2.0 device in your board,
	  say N to get a smaller uImage. Mostly you need it.

if HIUSB_DEVICE2_0

config HIUSB_DEVICE
	tristate "hisilicon highspeed device controller version 3.00a driver"
	default y
	help
	  You can select device mode by the option.
	  Enable hisi ehci controller driver.
	  Say Y to enable hisi usb2.0 ehci controller driver.
	  IF you do not use usb2.0 ehci device in your board, say N to get a
	  smaller uImage. Mostly you need it.

config HIUSBUDC_REG_BASE_ADDRESS
	hex "hisilicon highspeed device control register base address"
	default "0x10050000" if ARCH_HI3536

config HIUSBUDC_REG_BASE_ADDRESS_LEN
	hex "hisilicon highspeed device control register size length"
	default "0x40000" if ARCH_HI3536

config HIUSBUDC_IRQ_NUMBER
	int "hisilicon highspeed device interrupt number"
	default "54" if ARCH_HI3536

config HIUSBUDC_DMA_BUF_LENGTH
	int "hisilicon highspeed device dma buffer length"
	default "16384" if ARCH_HI3536

config HIUSBUDC_PHY_UTMI_BITWIDTH
	int "hisilicon highspeed device phy interface utmi bitwidth"
	default "8"

config HIUSB_SWITCH_HOST_DEVICE
	hex "host/device switch register address"
	default "0x1212007c" if ARCH_HI3536
	help
	  host/device switch register address

config SWITCH_HIUSB_HOST_DEVICE_BIT
	int "host/device switch set bit"
	default "31"

config HIUSB_OTG_SWITCH_TIME
	int "host/device detection interval(ms)"
	default "1000"
	help
	  host/device detection interval

endif # HI_HS_DEVICE
```

## drivers/usb/host/Kconfig.hiusb2_0
```kconfig
#
# hiusb Host Controller Drivers
#
comment "hiusb(ehci/ohci) Host Controller Drivers"
	depends on USB

menuconfig HIUSB_HOST2_0
	bool "hiusb2.0 usb host support"
	depends on ARCH_HI3521A
	default y if ARCH_HI3521A
	help
          This selects the usb(ehci/ohci) family usb host.
	  Say Y to enable hisi usb2.0 controller driver.
	  IF you do not use usb2.0 device in your board,
	  say N to get a smaller uImage. Mostly you need it.

if HIUSB_HOST2_0

config HIUSB_HOST
	bool "hisilicon usb host controller support"
	depends on ARCH_HI3521A
	default y if ARCH_HI3521A
	help
	  You can select host mode by the option.
	  when you select the option, usb2.0 host
	  driver can use. The code main to init the control.
	  If you want to use hisilicon usb control, you must select
	  the option.

config HIUSB_EHCI
	bool "hiusb-ehci usb host device support"
	depends on ARCH_HI3521A
	default y if ARCH_HI3521A
	help
	  Enable hisi ehci controller driver.
	  Say Y to enable hisi usb2.0 ehci controller driver.
	  IF you do not use usb2.0 ehci device in your board, say N to get a
	  smaller uImage. Mostly you need it.

config HIUSB_EHCI_IOBASE
	hex "hiusb-ehci IO address"
	default "0x10040000" if ARCH_HI3521A

config HIUSB_EHCI_IOSIZE
	hex "hiusb-ehci IO size"
	default "0x00010000"
	help
	  default is 0x10000.

config HIUSB_EHCI_IRQNUM
	int "hiusb-ehci irq number"
	default "51" if ARCH_HI3521A
	help
	  Please use the default value in this Kconfig, The default value
	  is the right value provided by hisi.

config HIUSB_OHCI
	bool "hiusb-ohci usb host device support"
	depends on ARCH_HI3521A
	default y if ARCH_HI3521A
	help
	  Enable hisi ohci controller driver.
	  Say Y to enable hisi usb2.0 ohci controller driver.
	  IF you do not use usb2.0 ohci device in your board, say N to get a
	  smaller uImage. Mostly you need it.

config HIUSB_OHCI_IOBASE
	hex "hiusb-ohci IO address"
	default "0x10030000" if ARCH_HI3521A

config HIUSB_OHCI_IOSIZE
	hex "hiusb-ohci IO size"
	default "0x00010000"
	help
	  default is 0x10000.

config HIUSB_OHCI_IRQNUM
	int "hiusb-ohci irq number"
	default "50" if ARCH_HI3521A
	help
	  Please use the default value in this Kconfig, The default value
	  is the right value provided by hisi.
endif # HIUSB_HOST2_0
```

## drivers/xor/Kconfig
```kconfig
menuconfig XOR_ENGINE
	tristate "XOR engine contrller driver"
	depends on (ARCH_HI3536)
	default n if (ARCH_HI3536)
	help
	  support xor logic
	  xor logic is an IP
	  that offload xor
	  calculation in SOC.

if XOR_ENGINE
config XOR_IOADDR
	hex "XOR IO address"
	default "0x12260000" if (ARCH_HI3536)

config XOR_IOSIZE
	hex "XOR IO size"
	default "0x00010000"

config XOR_IRQNUM
	int "XOR irq number"
	default "119" if (ARCH_HI3536)

config XOR_SYS_IOADDR
	hex "XOR System Config IO address"
	default "0x12040000" if (ARCH_HI3536)

config XOR_SYS_IOSIZE
	hex "XOR System Config IO size"
	default "0x00000100"

config XOR_POLL
	bool "use xor poll mode"
	default "y"
endif
```

## fs/notify/synotify/Kconfig
```kconfig
config SYNO_NOTIFY
	bool "Synology notification"
	select ANON_INODES
	select FSNOTIFY
	default y
	---help---
	  Say Y here to enable syno notify support for userspace, including the
	  associated system calls.  Syno notify allows monitoring of both files and
	  directories via a single open fd.  Events are read from the file
	  descriptor, which is also select()- and poll()-able.
	  Syno notify is whole mount point file system event monitor.

	  If unsure, say Y.
```

## synoconfigs/Kconfig
```kconfig
# For a description of the syntax of this configuration file,
# see Documentation/kbuild/kconfig-language.txt.
#

config SYNO_QORIQ
	bool "Synology P1022 porting define"
	depends on P1022_DS
	default y

config SYNO_QORIQ_FSL_SATA_NRESET
	bool "Increasing eSATA compatibility on QorIQ eSATA"
	depends on SYNO_QORIQ
	default y

config SYNO_QORIQ_FIX_DEEP_WAKE_FAIL
	bool "Fix wake from deepsleep fail issue"
	depends on SYNO_QORIQ
	default y

config SYNO_QORIQ_EN_DEEP_WAKE_PIN
	bool "Let deepsleep can wakeup by GPIO pin"
	depends on SYNO_QORIQ
	default y

config SYNO_QORIQ_ESPI_PM
	bool "support for pm in espi device"
	depends on SYNO_QORIQ
	default y

config SYNO_QORIQ_WOL_SPECIFY_PATTERN
	bool "support for wake up from user specify pattern"
	depends on SYNO_QORIQ
	default y

config SYNO_QORIQ_IGNORE_DEFAULT_GATEWAY_ARP
	bool "support for ignoring default gateway's ARP packet, which will wake up the machine"
	depends on SYNO_QORIQ
	default y

config SYNO_QORIQ_PHY_LED_SET
	bool "support PHY LED behavior control"
	depends on SYNO_QORIQ
	default y

config SYNO_QORIQ_FIX_DISK_WAKE_BEFORE_DEEPSLEEP
	bool "Fix disk will wakeup before deepsleep"
	depends on SYNO_QORIQ
	default y

config SYNO_QORIQ_DISABLE_KMSG_BEFORE_SYSSLEEP
	bool "Disable /proc/kmsg to prevent disk wakeup before system deepsleep, see bug <DSM> #55224"
	depends on SYNO_QORIQ
	default y

config SYNO_QORIQ_TALITOS_PM_SUPPORT
	bool "let talitos could support power management"
	depends on SYNO_QORIQ
	default y

config SYNO_QORIQ_FIX_SKB_RECYCLE
	bool "enhance gianfar's skb recycle"
	depends on SYNO_QORIQ
	default y

config SYNO_QORIQ_FIX_OCF_RACE
	bool "fix ocf race"
	depends on SYNO_QORIQ
	default y

config SYNO_QORIQ_NO_DISABLE_NON_BOOT_CPU
	bool "fix cannot poweroff DS with iSCSI enabled"
	depends on SYNO_QORIQ
	default y

config SYNO_QORIQ_CONTINUE_RESET_PCI_DEV_WHEN_RESUME_FAIL
	bool "fix resume failed when wakeup from deepsleep"
	depends on SYNO_QORIQ
	default y

config SYNO_QORIQ_CONTINUE_RESET_PCI_DEV_WHEN_RESUME_FAIL
	bool "fix resume failed when wakeup from deepsleep"
	depends on SYNO_QORIQ
	default y

config SYNO_QORIQ_TX_RESTART_HANG_FIX
	bool "fix tx queue restart hang fix"
	depends on SYNO_QORIQ
	default y

config SYNO_SAS_ENCLOSURE_ID_CTRL
	bool "This mechanism will help kernel to enum enclosure id control interface in sysfs"
	depends on SCSI_ENCLOSURE && ENCLOSURE_SERVICES
	default n

config SYNO_NET_INIT_OPERATION
	bool "fix the default eth0 status when booting without link"
	depends on SYNO_QORIQ
	default y

config SYNO_IGNORE_NETBIOS_BROADCAST
	default y
	bool "Export syno_ignore_netbios_broadcast to /proc"
	depends on GIANFAR && SYNO_QORIQ

config SYNO_MPC8533_TIMEBASE_FREQ
    int "PPC853x Timebase frequency"
    depends on SYNO_MPC8533
    default 0

config SYNO_QORIQ_ENABLE_PREFIX_CPU_AFFINITY
	bool "Choose this to bind irq/kthread on specified cpu"
	depends on SYNO_QORIQ

config SYNO_QORIQ_DEFAULT_CPU_AFFINITY
	int "Bind kernel thread on fixed cpu core"
	depends on SYNO_QORIQ
	depends on SYNO_QORIQ_ENABLE_PREFIX_CPU_AFFINITY
	default 0

config SYNO_QORIQ_GIANFAR_DROP_CACHE
	bool "Drop cache before gianfar device start up"
	depends on SYNO_QORIQ

config SYNO_213AIR_KERNEL_PANIC_WORK_AROUND
	bool "213 air xcopy work around"
	depends on SYNO_MV88F6281 && XFRM
	default y

config SYNO_DISPLAY_CPUINFO
    bool "Support display CPU Infomation"

config SYNO_SATA_PM_DEVICE_GPIO
	bool "Synology Specific PM Device Support"
	depends on SATA_PMP
	default y

config SYNO_NF_NAT_WORKAROUND
	bool "Fix BUG_ON on nf_nat_setup_info"
	default y

config SYNO_MD_SB_RETRY
	bool "Add an one-time retry for EIO error when updating superblock"
	default y
```
