## synoconfigs/Kconfig.misc
```kconfig
menu "MISC Features"

config SYNO_HDDMON
	tristate "Syno HDD monitor"
	depends on SYNO_ATA_PWR_CTRL && SYNO_HDD_HOTPLUG

config SYNO_SMBUS_HDDMON
	tristate "Syno SMBus HDD Monitor"

config SYNO_SMBUS_HDD_POWERCTL
	bool "Syno Control HDD power by SMBus"
	default n

config SYNO_PLUGIN_INTERFACE
	bool "Synology plugin interface for kernel modules"
	default y

config SYNO_INCREASE_READAHEAD
	bool "Increase default max readahead"
	default y

config SYNO_MAX_READAHEAD_SIZE
	int "Set default max readahead size"
	depends on SYNO_INCREASE_READAHEAD
	default "192" if X86_64
	default "512" if !X86_64

config SYNO_BLOCK_LIMIT_BAD_SECTOR_MSG
	bool "Reduce the rate of bad sector messages"
	default y

config SYNO_IO_ERROR_LIMIT_MSG
	bool "Reduce the rate of IO error print messages"
	default y

config SYNO_IO_ERROR_LIMIT_MSG_SHIFT
	int "Reduce the rate of IO error print messages - for the variable number"
	depends on SYNO_IO_ERROR_LIMIT_MSG
	default "12"

config SYNO_EMULATE_U64_DIVISOR
	bool "Emulate caculating of u64 remainder"
	default y

config SYNO_APPARMOR_PATCH
	bool "Declare APPARMOR usage for userspace"
	default y
	depends on SECURITY_APPARMOR

config SYNO_POWEROFF_INFO_PRINT
	bool "Show pma1 and pma2 in poweroff procedure"
	default n

config SYNO_LOWER_MD_RESYNC_NICE
	bool "Lower nice value to MD resync threads"
	depends on SYNO_ALPINE
	default n

config SYNO_FIX_DM_DISK_ALIGNMENT
	bool "Fix issue of device mapper disk alignment problem"
	default y

config SYNO_OOM_DUMP_MODULE
	bool "Dump modules and occupied memory sizes while OOM"
	default y

config SYNO_ELEVATE_LOG_LEVEL
	bool "Elevate log level of kernel log"
	default y

config SYNO_DEGRADE_LOG_LEVEL
	bool "degrade log level"
	default y

config SYNO_DYNAMIC_IDENTIFY_CPU_NAME
	bool "dynamic identify CPU name"
	default y
	depends on SYNO_BROADWELL

config SYNO_ARM64_CPU_MODELNAME_DISPLAY
	tristate "Display cpu model for arm64"
	default y
	depends on ARM64

config SYNO_SKIP_DETACH_DVB_USB_DIB0700
	bool "skip dvb_detach for dvb-usb-dib0700 driver"
	default y

config SYNO_SKIP_UNUSED_ERROR_LOG_PCTV452E
	bool "skip unused error log from pctv452e driver"
	default y

config SYNO_DISABL_HAVE_ARCH_HUGE_VMAP
	bool "diable HAVE_ARCH_HUGE_VMAP in 4.4 kernel"
	default n

config SYNO_PSTORE
	bool "Synology enhancement of Pstore mechanism"
	default n
	depends on PSTORE

config SYNO_FIX_RTC_WAKE_AFTER_POWER_FAILURE
	bool "fix rtc wake after power failure"
	default y
	depends on SYNO_X64

config SYNO_IE_SOFT_POWER_OFF
	bool "IE soft power off"
	depends on SYNO_PURLEY
	select ACPI_BUTTON
	default n

config SYNO_IE_SOFT_POWER_OFF
	bool "IE soft power off"
	depends on SYNO_PURLEY
	select ACPI_BUTTON
	default n

config SYNO_SATA_CHECK
	tristate "show sata chip amplitude/de-emphasis adjustment."
	default n

config SYNO_SATA_TEST
	bool "sata controller pci register sysfs setting interface for amplitude/de-emphasis adjustment."
	default n

config SYNO_SPECULATION_DEFAULT_OFF
	bool "Set speculation mitigation to default off"
	default n
	depends on PAGE_TABLE_ISOLATION

config SYNO_FIX_TICK_REPROGRAM
	bool "Fix tick reprogram bug"
	default n

config SYNO_FORCE_CF9_REBOOT
	bool "Support CF9 Force reboot"
	default n
	depends on X86_64

endmenu #MISC Features

menu "Cgroup"

endmenu #Cgroup

config SYNO_CGROUP_SKIP_MEMCG
	bool "skip memcg check in critical path"
	default y
	depends on MEMCG

menu "Encryption"

config SYNO_KEY
	bool "use keys supply by our system"
	depends on KEYS

config SYNO_SYSTEM_UNTRUSTED_KEYRING
	bool "Provide system-wide ring of untrusted keys"
	depends on KEYS

config SYNO_SYSTEM_UNTRUSTED_KEYS
	string "Additional X.509 keys for default system untrusted keyring"
	depends on SYNO_SYSTEM_UNTRUSTED_KEYRING

config SYNO_REMOVE_X509_DATE_VALIDATION_CONSTRAIN
	bool "Remote x509 date validation constrain"
	depends on KEYS

endmenu #Encryption

menu "Udev"

config SYNO_DEPRECATED_UEVENT_ENV
	bool "Export deprecate uevent environment to userspace"
	default y

endmenu #Udev

menu "Bios Log"

config SYNO_MEMORY_TRAINING_FAILED_LOG
	bool "Print the MRC postcode if memory training fail happened at last boot up"
	depends on X86
	default y

config SYNO_MRC_POSTCODE_CMOS_ADDR
	hex "The address of cmos storing failed MRC postcode"
	depends on SYNO_MEMORY_TRAINING_FAILED_LOG
	default 0x48

endmenu #BIOS LOG
```

## synoconfigs/Kconfig.network
```kconfig
menu "Network"

config SYNO_SWITCH_NET_DEVICE_NAME
	bool "Switch net device name to collocate with hardware design"
	default n

config SYNO_MAX_SWITCHABLE_NET_DEVICE
	int "Max number of switch net device name"
	default 8
	depends on SYNO_SWITCH_NET_DEVICE_NAME

config SYNO_NET_DEVICE_ENCODING_LENGTH
	int "Encoding length of net device"
	default 6
	depends on SYNO_SWITCH_NET_DEVICE_NAME

config SYNO_SKIP_RXDROP_BY_CORE
	bool "Skip RX packets drop is increasing"
	default y

config SYNO_REMOVE_TCP_DEBUG
	bool "Remove tcp debug message"
	default y

config SYNO_IPV6_RFC_4862
	bool "IPv6 Stateless Address Autoconfiguration"
	default y

config SYNO_BONDING_INIT_STATUS
	bool "Initial the bonding status"
	default y

config SYNO_BONDING_FIX_ACTIVE
	bool "Fix a bug in active backup bonding mode"
	default y

config SYNO_IPV6_LINKLOCAL
	bool "Assign an interface to IPV6 link local address automatically."
	default y

config SYNO_COMPAT_WIRELESS
	bool "Select kernel config for compat-wireless"
	default y
	select WIRELESS_EXT
	select WEXT_PRIV

config SYNO_SFP_UNSUPPORTED_NOTIFY
	bool "SFP+ module unsupported notify"
	default y

config SYNO_PHY_INIT
	bool "syno initialization of phy device"
	default n

config SYNO_PHY_INIT_88E1514
	bool "Enable phy driver of the phy 88E1514"
	default y
	depends on SYNO_PHY_INIT

config SYNO_IPV6_EXPORT_IN6ADDR_ANY
	bool "Export in6addr_any value for modules"
	default y

config SYNO_CVE_2016_5696
	bool "Fix CVE-2016-5696"
	default y

endmenu #Network
```

## synoconfigs/Kconfig.platform
```kconfig
menu "Platform Selection"

config SYNO_X64
	bool
	default y
	depends on X86_64

config SYNO_SELECT_PLATFORM
	def_bool y
choice
	prompt "Synology platform"

config SYNO_BROMOLOW
	bool "Intel-Bromolow"
	depends on X86_64

config SYNO_GRANTLEY
	bool "Intel Grantley"
	depends on X86_64

config SYNO_AVOTON
	bool "Intel-Avoton"
	depends on X86_64

config SYNO_BRASWELL
	bool "Intel-Braswell"
	depends on X86_64

config SYNO_APOLLOLAKE
	bool "Intel-Apollolake"
	depends on X86_64

config SYNO_KVMX64
	bool "KVM X64 Virtual machine"
	depends on X86_64

config SYNO_BROADWELL
	bool "Intel-Broadwell"
	depends on X86_64

config SYNO_DENVERTON
	bool "Intel-Denverton"
	depends on X86_64

config SYNO_DOCKERX64
	bool "Docker X64 Virtual machine"
	depends on X86_64

config SYNO_RTD1296
	bool "realtek rtd1296"
	depends on ARM64

endchoice

config SYNO_DUAL_HEAD
	bool "Synology Dual Head Host"
	default n
	depends on SYNO_BROMOLOW || SYNO_BROADWELL

config SYNO_SAS
	bool "Synology SAS Support"
	default y
	depends on SYNO_BROMOLOW || SYNO_BROADWELL || SYNO_GRANTLEY

endmenu #Platform Selection
```
