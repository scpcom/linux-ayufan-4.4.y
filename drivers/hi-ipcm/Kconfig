## drivers/hi-ipcm/Kconfig
```kconfig
menuconfig HI3536_IPCM
	tristate "Hi3536 ipcm added"
	depends on  (ARCH_HI3536 || ARCH_HI3536_SLAVE)
	help
	  The hi3536 ipcm module support the communication
	  between the cpu a17 and a7, there are some paramters
	  for this module should be set.
	  for example, shared memory base address, share memory
	  size, irq number and so on.

if HI3536_IPCM
config HIIPCM_IRQNUM
	int "hiipcm irq number"
	default "7" if (ARCH_HI3536 || ARCH_HI3536_SLAVE)

config HIIPCM_SHARE_MEM_ADDR
	hex "hiipcm share mem address"
	default "0x04010000" if (ARCH_HI3536 || ARCH_HI3536_SLAVE)

config HIIPCM_SHARE_MEM_SIZE
	hex "hiipcm share mem size"
	default "0x00006000"

config HIIPCM_DATA_REG_BASE
	hex "hiipcm data register base address"
	default "0x12050000" if (ARCH_HI3536 || ARCH_HI3536_SLAVE)


config HIIPCM_CPU_ID
	int "CPU ID(0:A17, 1:A7)"
	default "0" if ARCH_HI3536
	default "1" if ARCH_HI3536_SLAVE
	help
	  The cpu id of ipcm, ipcm module runs in A17, IPCM_CPU_ID=0;
          ipcm runs in A7, IPCM_CPU_ID=1.

          /* cpu id definitions */
          typedef enum {
               IPCM_CPU_ID_A17,          /* 0x0 */
               IPCM_CPU_ID_A7,           /* 0x1 */
          } ipcm_cpu_id_t;

config HIIPCM_IRQ_STATISTIC_ENABLE
	bool "enable hi-ipcm irq number statistic"
	default "0"
	help
	  If enable this option
	  (HIIPCM_IRQ_STATISTIC_ENABLE = 1),
	  the hi-ipcm module would statistic
	  the sent and received number of irq.

config HIIPCM_WAIT_TIMEOUT
	int "hiipcm wait timeout"
	default "5" if (ARCH_HI3536 || ARCH_HI3536_SLAVE)
	help
	  The wait timeout value for hiipcm module.
	  It's unit of this value is second. The
	  default value 5, means the max wait time
	  is 5s.

endif
```

## drivers/hidmacv300/Kconfig
```kconfig
menuconfig HIDMAC_V300
	tristate "Hisilicon DMA Controller V300"
	depends on ARCH_HI3536
	default y if ARCH_HI3536
	help
	  This is the driver for hisilicon DMA controoller
	  IP.

if HIDMAC_V300

config HIDMAC_BASE_ADDR
	hex "HIDMACV300 base address"
	default "0x12280000" if (ARCH_HI3536)

config HIDMAC_IOSIZE
	hex "HIDMACV300 IO size"
	default "0x00003000"

config HIDMAC_IRQNUM
	int "HIDMACV300 irq number"
	default "43" if (ARCH_HI3536)

config HIDMAC_SYS_IOADDR
	hex "HIDMACV300 System Config IO address"
	default "0x12040000" if (ARCH_HI3536)

config HIDMAC_SYS_IOSIZE
	hex "HIDMACV300 System Config IO size"
	default "0x00000100"

config HIDMAC_CHN_NUM
	int "HIDMACV300 max channel number"
	default 8

config HI_DMAC_MISC_DEV
	bool "HIDMACV300 misc dev"
	default y if (ARCH_HI3536)
	depends on HIDMAC_V300

config HI_IOMMU
	bool "Hisi Iommu Support"
	default y if (ARCH_HI3536)
	depends on HIDMAC_V300

if HI_IOMMU
config  HI_IOMMU_IO_BASE
	hex "Hisi Iommu IO Address"
	default "0x131f0000" if (ARCH_HI3536)

config  HI_IOMMU_IO_SIZE
	hex "Hisi Iommu IO size"
	default "0x00010000" if (ARCH_HI3536)

config  HI_IOMMU_IRQ_START
	int "Hisi Iommu Irq Number"
	default "94" if (ARCH_HI3536)

config HI_IOMMU_THRESHOLD
	int "Hisi Iommu threshold KBytes"
	range 4 128
	default "64" if (ARCH_HI3536)
endif
endif
```

## drivers/i2c/chips/Kconfig
```kconfig
#
# Miscellaneous I2C chip drivers configuration
#
# *** DEPRECATED! Do not add new entries! See Makefile ***
#

menu "Miscellaneous I2C Chip support"

config EEPROM_AT
	tristate "I2c-eeprom-at"
	depends on I2C
	help
	  This provides an interface to read and write the EEPROM and reset the chip.

endmenu
```

## drivers/mtd/devices/hisfc350/Kconfig
```kconfig
#
# hisilicon spi flash controller device version 350
#

menuconfig MTD_HISFC350
	tristate "hisilicon spi flash controller device version 350 driver"
	depends on (ARCH_HI3536)
	default y if (ARCH_HI3536)
	select MTD_SPI_IDS
	help
	  Hisilicon spi flash controller device version 350.
	  Hisilicon spi flash controller version 350 support
	  DMA transfers while reading and write the spi flash,
	  which will improve the performace very much.

if MTD_HISFC350

config HISFC350_SYSCTRL_ADDRESS
	hex "cpu system control register base address"
	default "0x12040000" if (ARCH_HI3536)

config HISFC350_BUFFER_BASE_ADDRESS
	hex "hisfc350 read/write memory base address"
	default "0x15000000" if (ARCH_HI3536)

config HISFC350_REG_BASE_ADDRESS
	hex "hisfc350 register base address"
	default "0x10010000" if (ARCH_HI3536)

config HISFC350_CHIP_NUM
	int "hisfc350 spi chip number"
	default 2 if (ARCH_HI3536)

config HISFC350_SHOW_CYCLE_TIMING
	bool "show spi read/write/erase cycle timing"
	default n if (ARCH_HI3536)
	help
	  Show spi read/write/erase cycle timing, command, clock.
	  This is a debug option. When enabled, some command and
	  cycles uesed on operations will show for you.
	  If unsure, say no.

config HISFC350_ENABLE_CHIPSELECT_0
	bool "use spi device on chipselect 0"
	default n if (ARCH_HI3536)
	help
	  If set this value to y, indicates that enable
	  the chip select 0; set this value to n, means
	  to disable the chip select 0. The default value
	  of HISFC350_ENABLE_CHIPSELECT_0 is n.

config HISFC350_ENABLE_CHIPSELECT_1
	bool "use spi device on chipselect 1"
	default y if (ARCH_HI3536)
	help
	  If set this value to y, indicates that enable
	  the chip select 1; set this value to n, means
	  to disable the chip select 1. The default value
	  of HISFC350_ENABLE_CHIPSELECT_1 is y.

config HISFC350_ENABLE_INTR_DMA
	bool "use the IRQ mode of spi device R/W"
	default n if (ARCH_HI3536)

endif # MTD_HISFC350
```

## drivers/net/fsl_pci_veth/Kconfig
```kconfig
#
# Boardnet configuration
#

menu "MPC85xx PCI agent mode driver"
	depends on NETDEVICES && MPC85xx && PCI && m

config CARDNET
	tristate "Cardnet driver support"
	---help---
	  cardnet driver is a simulating ethernet driver for MPC85xx
	  board when it acts as Agent/EP device.
	  If MPC85xx board acts as PCI Agent/EP and want to communicate with
	  the Host/RC through PCI interface, enable this cardnet driver and there
	  will be an ethernet device named cethx in the system. Corporating with
	  another ethernet device named bethx in the Host/RC system, the Host/RC and
	  Agent/EP can send package to each other.

config PCI_EP_N
	int "Default PCI port configured as Agent/EP"
	default "3"
	depends on CARDNET
	help
	  The default pci port which configured as Agent/EP.

endmenu

menu "MPC85xx board PCI demo driver"
	depends on NETDEVICES && MPC85xx && PCI && m

config BOARDNET
	tristate "Boardnet driver support"
	---help---
	  Boardnet driver is a simulate ethernet driver for MPC85xx board
	  when it act as PCI host/RC.
	  If MPC85xx board acts as PCI Host/RC and want to communicate
	  with another MPC85xx board(act as Agent/EP) through PCI interface,
	  enable this boardnet driver and there will be an ethernet device named
	  bethx in the system. Corporating with another ethernet device named
	  cethx in the Agent/EP system,the Host/RC and Agent/EP can send package
	  to each other.

endmenu
```

## drivers/net/wireless/rtl8192cu-fixes/Kconfig
```kconfig
config RTL8192CU
	tristate "Realtek RTL8192C USB WiFi"
	depends on USB
	---help---
	  Help message of RTL8192CU
```

## drivers/net/wireless/rtl8192cu-fixes/Kconfig.bak
```kconfig
config RTL8192C
	tristate "Realtek RTL8192C USB WiFi"
	depends on USB
	---help---
	  Help message of RTL8192CU
```

## drivers/pci/hipcie/Kconfig
```kconfig
menuconfig HIPCIE
	bool "Hisilicon PCI Express support"
	depends on PCI && (ARCH_HI3536 || ARCH_HI3531A)
	default y if PCI
	default n if ! PCI
	help
	Hisilicon PCI Express support
	Choose this selection to support PCI Express uses.

if HIPCIE

menu "PCI Express configs"

config PCIE0_SEL
        bool "PCI Express controller 0 sel"
        default n if ! PCI
        default y if PCI
        depends on PCI
        help
        PCI Express controller 0 sel.
        Set n to disable controller 0 as RC.
        set y to enable controller 0 to work at RC mode.

config PCIE0_DEVICES_MEM_SIZE
        hex "Total memory size of PCI Express EP devices"
        range 0x0 0x10000000 if ARCH_HI3536
        default "0x10000000" if ARCH_HI3536
	range 0x0 0x8000000 if ARCH_HI3531A
        default "0x8000000" if ARCH_HI3531A
        depends on PCIE0_SEL
        help
        Memory available for all pcie EP devices in pci subsystem.
        Hisilicon PCI Express controller provides up to 256MBytes address
	space for its subordinated devices.
	No IO address space is reserved, since to support PCI legacy devices
	which required IO address space.
        You can change this value as you please.

config PCIE0_DEVICES_CONFIG_SIZE
        hex "Sum of configuration header size mapped for all PCIe EP devices"
        range 0x0 0x10000000   if ARCH_HI3536
        default 0x800000       if ARCH_HI3536
	range 0x0 0x8000000    if ARCH_HI3531A
        default 0x800000       if ARCH_HI3531A
        depends on PCIE0_SEL
        help
	As to the PCIe address space configuration, address space for all EPs
	is up to 256Mbytes. But, normally people do not used that much. Each
	EP device will use 4Kbytes virtual address space for PCIe configuration header.
	Normally people will not use that much(256MB).
	Enlarge this value will require more system virtual address space.
	The DEFAULT value(8MB) is enough for most applications.

config LIMIT_MAX_RD_REQ_SIZE
	bool "limit pcie max read request size"
	default n
	depends on PCI && ARCH_HI3536
	help
	The default max read request size of pcie device is 512 Byte. When hi3536 use
	the card of pcie-to-sata to connect to the sata disk, with the default max read
	request size value of 512 byte, would cause the low bandwidth of VDP. If you enable
	the LIMIT_MAX_RD_REQ_SIZE config, the max read request size of pcie device would be
	set to 256 byte, and the problem of VDP low band width also be avoided.

config PCIE1_SEL
	bool "PCI Express controller 1 sel"
	default n if !PCI
	default y if PCI
	depends on PCI && ARCH_HI3531A
	help
	PCI Express controller 1 sel.
	Set n to disable controller 1,
	set y to enable controller 1 to work at RC mode.

config PCIE1_DEVICES_MEM_SIZE
	hex "Total memory size of PCI Express EP devices"
	range 0x0 0x8000000 if ARCH_HI3531A
	default "0x8000000" if ARCH_HI3531A
	depends on PCIE1_SEL
	help
	All memory size required by all devices in pci subsystem.
	Hisilicon PCI Express controller provide up to 128MBytes address
	space for its subordinated devices.
	No IO address space is reserved, since to support PCI legacy devices
	which required IO address space.
	You can change this value as you please.

config PCIE1_DEVICES_CONFIG_SIZE
	hex "Total configuration header size of PCI Express system devices"
	range 0x0 0x8000000    if ARCH_HI3531A
	default 0x800000       if ARCH_HI3531A
	depends on PCIE1_SEL
	help
	All configuration size required by devices connnect to
	Hisilicon PCI Express controller.
	NOTE: This will alloc memory from kernel,
	enlarge this will require the same memory.
	The default value is enough for most applications.

endmenu

endif
```

## drivers/phy/freescale/Kconfig
```kconfig
# SPDX-License-Identifier: GPL-2.0-only
config PHY_FSL_IMX8MQ_USB
	tristate "Freescale i.MX8M USB3 PHY"
	depends on OF && HAS_IOMEM
	select GENERIC_PHY
	default ARCH_MXC && ARM64

config PHY_MIXEL_MIPI_DPHY
	tristate "Mixel MIPI DSI PHY support"
	depends on OF && HAS_IOMEM
	select GENERIC_PHY
	select GENERIC_PHY_MIPI_DPHY
	select REGMAP_MMIO
	help
	  Enable this to add support for the Mixel DSI PHY as found
	  on NXP's i.MX8 family of SOCs.

config PHY_LS2014A_SERDES
	tristate "Freescale LS1024A SerDes PHY driver"
	depends on ARCH_LS1024A || COMPILE_TEST
	depends on HAS_IOMEM
	select GENERIC_PHY
	select MFD_SYSCON
	help
	  This option enables support for the Snowbush SerDes PHY found
	  in Freescale LS1024A SoC.
	  It is required for PCIe and SATA operation on those SoCs.
```

## drivers/pinctrl/realtek/Kconfig
```kconfig
if SYNO_LSP_RTD129X
config PINCTRL_RTD129X
	bool "RTD129X pin controller driver"
	select PINMUX
	select GENERIC_PINCONF
endif # SYNO_LSP_RTD129X

if SYNO_LSP_RTD1619
config PINCTRL_RTD119X
        bool "RTD119X pin controller driver"
        depends on ARCH_RTD119X
        default y
        select PINMUX
        select GENERIC_PINCONF

config PINCTRL_RTD129x
	bool "RTD129x pin controller driver"
	depends on ARCH_RTD129x
	default y
	select PINMUX
	select GENERIC_PINCONF

config PINCTRL_RTD139x
	bool "RTD139x pin controller driver"
	depends on ARCH_RTD139x
	default y
	select PINMUX
	select GENERIC_PINCONF

config PINCTRL_RTD16xx
	bool "RTD16xx pin controller driver"
	depends on ARCH_RTD16xx
	default y
	select PINMUX
	select GENERIC_PINCONF

config PINCTRL_RTD13xx
	bool "RTD13xx pin controller driver"
	depends on ARCH_RTD13xx
	default y
	select PINMUX
	select GENERIC_PINCONF
endif # SYNO_LSP_RTD1619
```

## drivers/soc/Kconfig
```kconfig
menu "SOC (System On Chip) specific Drivers"

source "drivers/soc/brcmstb/Kconfig"
source "drivers/soc/mediatek/Kconfig"
source "drivers/soc/qcom/Kconfig"
source "drivers/soc/rockchip/Kconfig"
source "drivers/soc/sunxi/Kconfig"
source "drivers/soc/ti/Kconfig"
source "drivers/soc/versatile/Kconfig"
if SYNO_LSP_RTD129X || SYNO_LSP_RTD1619
source "drivers/soc/realtek/Kconfig"
endif # SYNO_LSP_RTD129X || SYNO_LSP_RTD1619

endmenu
```

## drivers/soc/friendlyelec/Kconfig
```kconfig
#
# Machine drivers
#

if ARCH_ROCKCHIP

config MACH_NANOPI4
	bool "FriendlyElec NanoPi 4 Series Machine"
	default n

config MACH_NANOPI_R2
	bool "FriendlyElec boards based on RK3328"
	default n

endif
```

## drivers/soc/fsl/ls2-console/Kconfig
```kconfig
config FSL_LS2_CONSOLE
        tristate "Layerscape MC and AIOP console support"
	depends on SOC_LS1021A || ARCH_FSL_LS2085A
        default y
```

## drivers/soc/realtek/Kconfig
```kconfig
if SYNO_LSP_RTD129X
config RTD129X
	bool "Realtek SoC drivers support"
	depends on ARCH_RTD129X
	default y
	help
	  Realtek RTD1296 SOC drivers support.

	  If unsure, say N.

if RTD129X
source "drivers/soc/realtek/rtd129x/Kconfig"
endif # RTD129X
endif # SYNO_LSP_RTD129X

if SYNO_LSP_RTD1619
config RTD16xx
	bool "Realtek RTD16xx SoC family specific drivers"
	depends on ARCH_RTD16xx
	default y
	help
	  Realtek RTD16xx SoC family specific support.

	  If unsure, say N.

if RTD16xx
source "drivers/soc/realtek/rtd16xx/Kconfig"
endif # RTD16xx

config RTD16xx_FPGA
	bool "Realtek RTD16xx FPGA"
	depends on ARCH_RTD16xx
	select RTK_PLATFORM_FPGA
	default n
	help
	  FPGA without boot code.


config RTK_PLATFORM_FPGA
	def_bool n
endif # SYNO_LSP_RTD1619

if SYNO_LSP_RTD129X || SYNO_LSP_RTD1619
source "drivers/soc/realtek/common/Kconfig"
endif # SYNO_LSP_RTD129X || SYNO_LSP_RTD1619
```
