## drivers/soc/realtek/common/Kconfig
```kconfig
if SYNO_LSP_RTD1619
config RTK_SB2_SECURITY_DEBG
	bool "Realtek system bridge security mode debug"
	depends on HAVE_ARM_SMCCC
	default n
	help
	  Enable helper functions for Realtek system bridge security mode debug. If unsure, say N.
endif # SYNO_LSP_RTD1619

config RTK_RBUS_BARRIER
	bool "Realtek rbus barrier"
	depends on RTK_MEM_REMAP
	default y
	help
	  Enable helper functions for R-bus barrier. If unsure, say N.

config RTK_MEM_REMAP
	bool "Realtek memory remap"
	default y
	help
	  Enable helper functions for static ioremap. If unsure, say N.

if SYNO_LSP_RTD1619
config RTK_ACPU_RELOAD
	bool "Realtek dynamic ACPU reload"
	default n
	help
	  Dynamic ACPU stop/start mechanism. If unsure, say N.

config RTK_IPCSHM_RESET
	bool "Dynamic IPC share memory reset"
	depends on RTK_ACPU_RELOAD
	default n
	help
	  Reset IPC_SHM when performing dynamic ACPU stop/start. If unsure, say N.

config RTK_REGMAP_I2C
	bool
	select REGMAP

config RTK_REGMAP_MMIO
	bool
	select REGMAP

config RTK_REGMAP_SECURE_MMIO
	bool
	select RTK_REGMAP_MMIO
	depends on HAVE_ARM_SMCCC

config RTK_MMIO
	bool
	select REGMAP_MMIO

config RTK_SECURE_DVFS
	bool
	default y if ARCH_RTD16xx
	select RTK_REGMAP_SECURE_MMIO
	select I2C_RTK_SECURE_ACCESS

config RTK_MCP
	bool "Realtek MCP driver"
	default n
	help
	  Realtek MCP driver


config RTK_VMX_ULTRA
	bool "VMX ultra boot enable"
	default n
	help
	  Set VMX ultra boot enable.

config RTK_AVCPU_LOG
	bool "Realtek AVCPU share memory logging system"
	depends on RTK_RPC
	help
	  Enable AVCPU share memory logging read from userspace
	  via device node.
endif # SYNO_LSP_RTD1619

source "drivers/soc/realtek/common/rpc/Kconfig"
source "drivers/soc/realtek/common/pwrctrl/Kconfig"
if SYNO_LSP_RTD1619
source "drivers/soc/realtek/common/Kconfig.workaround"
source "drivers/soc/realtek/common/hse/Kconfig"
source "drivers/soc/realtek/common/debug/Kconfig"
endif # SYNO_LSP_RTD1619

#
# Realtek codec configuration
#

menuconfig RTK_CODEC
	bool "Realtek Codec"
	default n

if RTK_CODEC

if ION
config RTK_RESERVE_MEMORY
	bool "RTK Reserve Memory for Video/Image Codec"
	default n
endif # ION

config VE1_CODEC
	bool "RTK Video Engine 1 Codec"
	default n

if SYNO_LSP_RTD129X
config VE3_CODEC
	bool "RTK Video Engine 3 Codec"
	default n
endif # SYNO_LSP_RTD129X

config IMAGE_CODEC
	bool "RTK Image Codec"
	default n

endif # RTK_CODEC
```

## drivers/soc/realtek/common/pwrctrl/Kconfig
```kconfig
menu "Power Control"

config POWER_CONTROL
	bool "Power Control Support"
	default n if SYNO_LSP_RTD129X

config POWER_CONTROL_DEBUGFS
	bool "DebugFs for Power Control"
	depends on POWER_CONTROL
	default y if POWER_CONTROL && SYNO_LSP_RTD1619
	default n if SYNO_LSP_RTD129X

if SYNO_LSP_RTD1619
config POWER_CONTROL_REALTEK
	bool

config POWER_CONTROL_PD_SRAM
	bool

config POWER_CONTROL_PD_SRAM_CH
	bool

config POWER_CONTROL_PD_SIMPLE
	bool

config POWER_CONTROL_PD_DUMMY
	bool
endif # SYNO_LSP_RTD1619

config POWER_CONTROL_RTD129X
	bool "RTD129X SoC Power Controller"
	depends on POWER_CONTROL
	depends on SYNO_LSP_RTD129X || ARCH_RTD129x && SYNO_LSP_RTD1619
	select PM_GENERIC_DOMAINS if SYNO_LSP_RTD1619
	select POWER_CONTROL_REALTEK if SYNO_LSP_RTD1619
	select POWER_CONTROL_PD_SRAM if SYNO_LSP_RTD1619
	select POWER_CONTROL_PD_SRAM_CH if SYNO_LSP_RTD1619
	select POWER_CONTROL_PD_SIMPLE if SYNO_LSP_RTD1619
	default y if SYNO_LSP_RTD1619
	default n if SYNO_LSP_RTD129X
	help
	  Realtek RTD129x Soc Power Controller Driver.

if SYNO_LSP_RTD129X
config POWER_CONTROL_RTD129X_DEBUGFS
	bool "DebugFs for RTD192x Power Control"
	depends on POWER_CONTROL_RTD129X
	default n
endif # SYNO_LSP_RTD129X

config POWER_CONTROL_RTD139X
	bool "RTD139X SoC Power Controller"
	depends on POWER_CONTROL
	depends on ARCH_RTD139x
	select PM_GENERIC_DOMAINS
	select POWER_CONTROL_REALTEK
	select POWER_CONTROL_PD_SRAM
	select POWER_CONTROL_PD_SIMPLE
	default y
	help
	  Realtek RTD139x Soc Power Controller Driver.

config POWER_CONTROL_RTD16XX
	bool "RTD16XX SoC Power Controller"
	depends on POWER_CONTROL
	depends on ARCH_RTD16xx
	select PM_GENERIC_DOMAINS
	select POWER_CONTROL_REALTEK
	select POWER_CONTROL_PD_SRAM
	select POWER_CONTROL_PD_SIMPLE
	default y
	help
	  Realtek RTD16xx Soc Power Controller Driver.
endmenu
```

## drivers/soc/realtek/common/rpc/Kconfig
```kconfig
config RTK_RPC
	bool "Realtek RPC driver"
	depends on RTK_MEM_REMAP
	default n if SYNO_LSP_RTD129X
	default y if SYNO_LSP_RTD1619
	help
	  Realtek RPC driver with audio CPU
```

## drivers/soc/realtek/rtd129x/Kconfig
```kconfig
comment "RTD129X Device Drivers"

menu "RTD129X Device Drivers"

config RTK_SB2_MEM_TRASH_MONITOR
	bool "Memory trash monitor"
	default n
	help
	  Enable helper functions for memory trash detection. If unsure, say N.

# config RTK_RBUS_BARRIER see ./drivers/soc/realtek/common/Kconfig
# config RTK_MEM_REMAP see ./drivers/soc/realtek/common/Kconfig

source "drivers/soc/realtek/rtd129x/rtk_ve/Kconfig"
source "drivers/soc/realtek/rtd129x/irda/Kconfig"
source "drivers/soc/realtek/rtd129x/rpc/Kconfig"
endmenu #RTD129X Device Drivers

menu "Realtek NAS support"
       depends on ARCH_RTD129X
 
config SENDFILE_PATCH
       bool "Reverse sendfile patch"
       default n
       help
       Use patched sendfile syscall to improve write performance on NAS.

endmenu
```

## drivers/spi2/Kconfig
```kconfig
#
# Character device configuration
#

menu "SPI2 support"
	depends on (ARCH_COMCERTO)
config SPI2
	tristate "Mindspeed SPI support"
	help
	  Mindspeed SPI (Serial Pheripheral Interface bus) core support

source drivers/spi2/busses/Kconfig

endmenu
```

## drivers/spi2/busses/Kconfig
```kconfig
menu "SPI Hardware Bus support"
	depends on SPI2

config SPI2_MSPD_LOW_SPEED
	tristate "Comcerto Low-speed"
	depends on SPI2
	default y

config SPI2_MSPD_HIGH_SPEED
	tristate "Comcerto High-speed"
	depends on SPI2
	default y

endmenu
```

## drivers/synobios/Kconfig
```kconfig
#
# Synology Hardware Monitor Module configuration
#

menu "Synology Hardware Monitor Module (synobios)"

config SYNOBIOS_PPC85XX
	tristate "Synobios for SYNO_854X and SYNO_853X (FreeScale MPC85XX)"
	depends on SYNO_MPC85XX_COMMON
	help
	  Synology SYNO_854X and SYNO_853X synobios

menuconfig  SYNOBIOS_6281
	tristate "Synology 6281 based synobios"
	depends on MACH_SYNOLOGY_6281 || SYNO_MV88F6281
	help
		synology based 6281 synobios

if SYNOBIOS_6281

config SYNOBIOS_109_MV
    tristate "Synobios for DS109 (Marvell 88F6281)"
    depends on MACH_SYNOLOGY_6281 || SYNO_MV88F6281
	default m if MACH_SYNOLOGY_6281 || SYNO_MV88F6281
    help
      Synology DS109 synobios

config SYNOBIOS_209_MV
    tristate "Synobios for DS209 (Marvell 88F6281)"
    depends on MACH_SYNOLOGY_6281 || SYNO_MV88F6281
    default m if MACH_SYNOLOGY_6281 || SYNO_MV88F6281
    help
      Synology DS209 synobios

config SYNOBIOS_409slim_MV
    tristate "Synobios for DS409slim (Marvell 88F6281)"
    depends on MACH_SYNOLOGY_6281 || SYNO_MV88F6281
    default m if MACH_SYNOLOGY_6281 || SYNO_MV88F6281
    help
      Synology DS409slim synobios

config SYNOBIOS_409_MV
    tristate "Synobios for DS409 (Marvell 88F6281)"
    depends on MACH_SYNOLOGY_6281 || SYNO_MV88F6281
    default m if MACH_SYNOLOGY_6281 || SYNO_MV88F6281
    help
      Synology DS409 synobios

config SYNOBIOS_RS409_MV
    tristate "Synobios for RS409 (Marvell 88F6281)"
    depends on MACH_SYNOLOGY_6281 || SYNO_MV88F6281
    default m if MACH_SYNOLOGY_6281 || SYNO_MV88F6281
    help
      Synology RS409 synobios

config SYNOBIOS_110j_MV
	tristate "Synobios for DS110j (Marvell 88F6281)"
	depends on MACH_SYNOLOGY_6281 || SYNO_MV88F6281
	default m if MACH_SYNOLOGY_6281 || SYNO_MV88F6281
	help
	  Synology DS110j synobios

config SYNOBIOS_210j_MV
	tristate "Synobios for DS210j (Marvell 88F6281)"
	depends on MACH_SYNOLOGY_6281 || SYNO_MV88F6281
	default m if MACH_SYNOLOGY_6281 || SYNO_MV88F6281
	help
	  Synology DS210j synobios

config SYNOBIOS_110_MV
    tristate "Synobios for DS110 (Marvell 88F6281)"
    depends on MACH_SYNOLOGY_6281 || SYNO_MV88F6281
    default m if MACH_SYNOLOGY_6281 || SYNO_MV88F6281
    help
      Synology DS110 synobios

config SYNOBIOS_410j_MV
	tristate "Synobios for DS410j (Marvell 88F6281)"
	depends on MACH_SYNOLOGY_6281 || SYNO_MV88F6281
	default m if MACH_SYNOLOGY_6281 || SYNO_MV88F6281
	help
	  Synology DS410j synobios
endif

config SYNOBIOS_pineview_X86
        tristate "Synobios for RS810+/DS410+/DS710+/DS1010+ (Pineview)"
        depends on SYNO_X86 || SYNO_X64
        default m if SYNO_X86 || SYNO_X64
        help
          Synology RS810+/DS410+/DS710+/DS1010+ synobios

endmenu
```
