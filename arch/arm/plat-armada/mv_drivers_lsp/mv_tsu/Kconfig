## drivers/ata/Kconfig.hiahci
```kconfig
menuconfig HI_SATA
	bool "hisilicon sata device support"
	depends on (ARCH_HI3536 || ARCH_HI3521A || ARCH_HI3531A)
	default y if (ARCH_HI3536 || ARCH_HI3521A || ARCH_HI3531A)
	select ATA
	select ATA_VERBOSE_ERROR
	select SATA_PMP

if HI_SATA
config HI_SATA_IOBASE
	hex "hi sata IO address"
	default "0x11010000" if (ARCH_HI3536 || ARCH_HI3521A || ARCH_HI3531A)
	help
	  hisilicon sata io base address.

config HI_SATA_IOSIZE
	hex "hi sata IO size"
	default "0x00010000" if (ARCH_HI3536 || ARCH_HI3521A || ARCH_HI3531A)
	help
	  default is 0x10000.

config HI_SATA_IRQNUM
	int "hi sata irq number"
	default "59" if ARCH_HI3536
	default "49" if ARCH_HI3521A
	default "49" if ARCH_HI3531A
	help
	  hisilicon sata irq number.

config HI_SATA_PORTS
	int "hi sata port number"
	range 1 2 if (ARCH_HI3536 || ARCH_HI3521A)
	range 1 4 if ARCH_HI3531A
	default "2" if (ARCH_HI3536 || ARCH_HI3521A)
	default "4" if ARCH_HI3531A
	help
	  hisilicon sata port number.

config HI_SATA_MODE
	int "hi sata interworking speed mode(1.5G:0/3G:1/6G:2)"
	range 0 2 if (ARCH_HI3536 || ARCH_HI3521A || ARCH_HI3531A)
	default "1" if (ARCH_HI3536 || ARCH_HI3521A || ARCH_HI3531A)
	help
	  hisilicon interworking speed mode.

config HI_SATA_FBS
	int "hi sata FIS-Based switching"
	default 1
	range 0 1
	help
	  Hisatav200 supports FBS.
	  FBS is FIS-Based switching.
	  Choose y if you want to use it.

config HI_SATA_NCQ
	int "hi sata Native Command Queuing"
	default 1
	range 0 1
	help
	  Hisatav200 supports NCQ.
	  NCQ is Native Command Queuing.
	  Choose y if you want to use it.

config HI_SATA_PREEMPH
	hex "hi sata phy PX TX pre-emphasis"
	depends on (ARCH_HI3521A || ARCH_HI3520DV300)
	default 0x14451 if ARCH_HI3521A
	default 0x14451 if ARCH_HI3520DV300

config HI_SATA_AMPLITUDE
	hex "hi sata phy PX TX amplitude"
	depends on (ARCH_HI3521A || ARCH_HI3520DV300)
	default 0x8377eb8 if ARCH_HI3521A
	default 0x8377eb8 if ARCH_HI3520DV300

config HI_SATA_RAM
	bool "hi sata use RAM prdt"
	depends on (ARCH_HI3536 || ARCH_HI3531A)
	default n if (ARCH_HI3536 || ARCH_HI3531A)
	help
	  Hisatav200 supports RAM.
	  Set command table in RAM
	  Set PRDT in RAM
	  Offload CPU usage

if HI_SATA_RAM
config HI_SATA_RAM_CMD_BASE
	hex "hi sata use RAM cmd table"
	depends on ARCH_HI3536
	default "0x4020000" if ARCH_HI3536

config HI_SATA_RAM_CMD_IO_SIZE
	hex "the size of hi sata use RAM cmd table"
	depends on ARCH_HI3536
	default "0x400" if ARCH_HI3536

config HI_SATA_RAM_PRDT_BASE
	hex "hi sata use RAM prdt"
	depends on ARCH_HI3536
	default "0x4030000" if ARCH_HI3536

config HI_SATA_RAM_PRDT_IO_SIZE
	hex "the size of hi sata use RAM prdt"
	depends on ARCH_HI3536
	default "0x10000" if ARCH_HI3536

config HI_SATA_RAM_SG_NUM
	int "hi sata use RAM default sg number"
	range 1 168
	depends on ARCH_HI3536
	default "120" if ARCH_HI3536
endif
endif
```

## drivers/char/comcerto_otp/Kconfig
```kconfig
config COMCERTO_OTP
	tristate "Comcerto On-Chip OTP Memory Support"
	depends on ARCH_COMCERTO
	default y
	help
		If you say Y here, you will get support for a proc file,
		/proc/otp/islocked, that reports whether the Comcerto
		One-Time Programmable (and thus the device) is locked or
		not.

		If unsure, it is safe to say Y.
```

## drivers/clk/realtek/Kconfig
```kconfig
if SYNO_LSP_RTD129X
menuconfig COMMON_CLK_RTK
    bool "Clock driver for realtek"
    depends on ARCH_RTD129X
    default y

config COMMON_CLK_RTD129X
    bool "Clock driver for RTD129X"
    depends on COMMON_CLK_RTK
    default y

config COMMON_CLK_RTD129X_DEBUGFS
    bool "DebugFs for RTD129X clock driver"
    depends on DEBUG_FS && COMMON_CLK_RTD129X
endif # SYNO_LSP_RTD129X

if SYNO_LSP_RTD1619
config COMMON_CLK_REALTEK
	bool "Clock driver for realtek"
	select RTK_MMIO
	select RESET_CONTROLLER

config COMMON_CLK_REALTEK_DEBUG
	bool "Clock debug"
	select RTK_REGISTER_TRACKER
	default y
	help
	  Add a simple register tracker to clock

config COMMON_CLK_RTD16XX
	bool "Clock driver for RTD16xx"
	select COMMON_CLK_REALTEK
	default y if ARCH_RTD16xx

config COMMON_CLK_DUMMY
	bool "Dummy Clock"
	help
	  Dummy Clock, if not sure say N.

config RESET_MUX
	bool "Reset Controller Mux"
	default y if ARCH_RTD16xx
	help
	  A mux to select reset controll.
endif # SYNO_LSP_RTD1619
```

## drivers/clk/sun8i/Kconfig
```kconfig
# SPDX-License-Identifier: GPL-2.0-only
if CLK_SUNXI

config CLK_SUNXI_DDR
	tristate "Legacy A100 ddr clock drivers"
	default y
	help
	  Legacy ddr clock drivers being used on A100 SoCs.
	  These drivers are kept around for
	  Device Tree backward compatibility issues, in case one would
	  still use a Device Tree with one clock provider by
	  node. Newer Device Trees and newer SoCs use the drivers
	  controlled by CONFIG_SUNXI_CCU.

config CLK_SUN8IW15
	tristate "Legacy clock support for sun8iw15p1"
	default y
	depends on ARCH_SUN8IW15
	help
	  Legacy clock driver for sun8iw15p1.

endif
```

## drivers/cpuidle/Kconfig
```kconfig
config CPU_IDLE
	bool "CPU idle PM support"
	default ACPI
	help
	  CPU idle is a generic framework for supporting software-controlled
	  idle processor power management.  It includes modular cross-platform
	  governors that can be swapped during runtime.

	  If you're using an ACPI-enabled platform, you should say Y here.

config CPU_IDLE_GOV_LADDER
	bool
	depends on CPU_IDLE
	default y

config CPU_IDLE_GOV_MENU
	bool
	depends on CPU_IDLE && NO_HZ
	default y

config CPU_IDLE_ALPINE
	bool "CPU Idle Driver for Annapurna Labs Alpine SOC"
	depends on ARCH_ALPINE
	default y
	help
	  Select this to enable cpuidle on  Annapurna Labs Alpine SOC.
	  If unsure say Y.
```

## drivers/epn1802-ocf/Kconfig
```kconfig
#
# MindSpeed pfe support (added by Andy, 2014/07/08)
#

config OCF_M86XXX_ELP
	tristate "MindSpeed ocf support"
	default m
	---help---
		MindSpeed ocf kernel module
		(copied from "MindSpeed_OpenWRT/sdk-comcerto-openwrt-c2k_nas_3.1-rc2/package/mindspeed/pfe_ctrl")
```

## drivers/hardkernel/Kconfig
```kconfig
#
# Hardkernel sysfs configuration
#

if ARCH_ROCKCHIP

menu "Hardkernel features"

config ODROIDN1_SYSFS
	bool "Hardkernel ODROID-N1 sysfs Support"
	default y
	help
	   Hardkernel sysfs support based on RK3399

endmenu

endif
```
