## arch/arm/plat-armada/mv_drivers_lsp/mv_tsu/Kconfig
```kconfig
menu "TSU options"
	depends on MV_INCLUDE_TS

config  MV_TSU
	bool "Support for Marvell Transport Stream Interface"
#	depends on MV_INCLUDE_TS
	default n
choice
	prompt "TSU interface type"
	depends on MV_TSU
	default TSU_PARALLEL_IF_ARMADA

config TSU_SERIAL_IF_ARMADA
	bool "Serial Interface"
	select TSU_SERIAL_IF
	---help---
	The TSU will work in serial mode (2 ports).

config TSU_PARALLEL_IF_ARMADA
	bool "Parallel Interface"
	select TSU_PARALLEL_IF
	---help---
	The TSU will work in parallel mode (1 port).
endchoice

config TSU_SERIAL_IF
	depends on TSU_SERIAL_IF_ARMADA
	bool

config TSU_PARALLEL_IF
	depends on TSU_PARALLEL_IF_ARMADA
	bool


choice
	prompt "TSU Core-Clock"
	depends on MV_TSU
	default TSU_CORE_CLK_83MHZ_ARMADA

config TSU_CORE_CLK_71MHZ_ARMADA
	bool "71 MHz TSU Core Clock"
	select TSU_CORE_CLK_71MHZ

config TSU_CORE_CLK_83MHZ_ARMADA
	bool "83 MHz TSU Core Clock"
	select TSU_CORE_CLK_83MHZ

config TSU_CORE_CLK_91MHZ_ARMADA
	bool "91 MHz TSU Core Clock"
	select TSU_CORE_CLK_91MHZ

config TSU_CORE_CLK_100MHZ_ARMADA
	bool "100 MHz TSU Core Clock"
	select TSU_CORE_CLK_100MHZ

endchoice

config TSU_CORE_CLK_71MHZ
	depends on TSU_CORE_CLK_71MHZ_ARMADA
	bool

config TSU_CORE_CLK_83MHZ
	depends on TSU_CORE_CLK_83MHZ_ARMADA
	bool

config TSU_CORE_CLK_91MHZ
	depends on TSU_CORE_CLK_91MHZ_ARMADA
	bool

config TSU_CORE_CLK_100MHZ
	depends on TSU_CORE_CLK_100MHZ_ARMADA
	bool


config  MV_TSU_PKT_SIZE
        int "TSU packet size"
        depends on MV_TSU
	default 188
	range 188, 256
        ---help---
          Define the TS packet size to be used (Same for both ports)
	  Must be >= 188 and <= 256.

config  MV_TSU_PROC
	bool "Support for TSU proc interface"
	depends on MV_TSU
	default y
        ---help---
          Support Proc-fs interface to configuring the TS control driver.

endmenu
```

## arch/arm/plat-orion/Kconfig
```kconfig
if ARCH_KIRKWOOD

choice
	prompt "Marvell Kirkwood SoC type"
	default MV88F6281

config  MV88F6281
	bool "Kirkwood family SoC"
	---help---
	  Choosing this option will generate a linux kernel for the 88F6281/88F6192/88F6190/88F6180 SoC

endchoice


menu "Marvell Kirkwood SoC Options"
	depends on ARCH_KIRKWOOD

config JTAG_DEBUG
	bool "Enable JTAG by disable \"wait for interrupt\""
	depends on MV88F5181 || MV88F6183 || MV88F6281 || MV78XX0
	default n
	---help---
	  Enable the JTAG debugger taking over the CPU by disabling "wait for interrupt" idle loop."

menu "Marvell Kirkwood SoC Included Features"

config MV_INCLUDE_CESA
	bool "CESA Support"
	depends on MV88F5182 || MV88F5082 ||  MV88F5181L || MV88F6082 || MV88F6183 || MV88F6281 || MV78XX0
	default y
	---help---
	  Please don't change this configs unless you know what you are doing.

config MV_INCLUDE_TDM
	bool "Integrated TDM Support"
	depends on MV88F5181L || MV88F6281 || MV78XX0
	default y
	---help---
	  Please don't change this configs unless you know what you are doing.

config MV_INCLUDE_GIG_ETH
	bool "Giga Ethernet Support"
	depends on MV88F5181 || MV88F5182 || MV88F5082 || MV88F5181L || MV88F5180N || MV88F6082 || MV88F6183 || MV88F6281 || MV78XX0
	default y

config MV_INCLUDE_SPI
	bool "SPI Support"
	depends on MV88F6082 || MV88F6183 || MV88F6281 || (MV78XX0 && !MV78XX0_Z0)
	default y
	---help---
	  Please don't change this configs unless you know what you are doing.

config MV_INCLUDE_TS
	bool "TSU Support"
	depends on MV88F6281
	default n
	---help---
	  Please don't change this configs unless you know what you are doing.

config MV_INCLUDE_SWITCH
	bool "Ethernet Switch Support"
	default y

endmenu

config MV_GPP_MAX_PINS
	int
	default 32 if MV88F5181 || MV88F5180N || MV88F5182 || MV88F5082 || MV88F5181L || MV88F6082 || MV88F6183 || MV78XX0
	default 16 if MV88F1181 || MV88F1281
	default 64 if MV88F6281

config MV_DCACHE_SIZE
	hex
	default 0x8000 if MV88F5181 || MV88F5180N || MV88F5182 || MV88F5082 || MV88F5181L || MV88F1281 || MV78XX0
	default 0x4000 if MV88F6082 || MV88F6281

config MV_ICACHE_SIZE
	hex
	default 0x8000 if MV88F5181 || MV88F5180N || MV88F5182 || MV88F5082 || MV88F5181L || MV88F1281 || MV78XX0
	default 0x4000 if MV88F6082 || MV88F6281

config ARCH_SUPPORTS_BIG_ENDIAN
	bool
	default y

config USE_DSP
	bool "Use pld/ldrd/strd arm DSP instructions"
	default n


choice
	prompt "Protect from speculative instruction prefetch"
	depends on CACHE_FEROCEON_L2
	default MV_SP_I_FTCH_DB_INV

config MV_SP_I_FTCH_DB_INV
	bool "Double invalidate for DMA buffers"
	---help---
	  Choosing this option will add L2 invalidate for DMA recieved buffers before processing it,
	  This is done through the pci_unmap_sg/page/single APIs.

config MV_SP_I_FTCH_LCK_L2_ICACHE
	bool "Lock L2 I-cache"
	---help---
	  Choosing this option will lock L2 Icache.

config MV_SP_I_FTCH_NONE
	bool "Ignore"

endchoice


config MV_INTERNAL_REGS_SELECTIVE_MAPPING
	bool "Internal registers selective mapping"
	default n
	---help---
	  Choosing this option enables selective address mapping for each unit,
	  in the internal registers address space.

config  KIRKWOOD_PROC
	bool "Support for MV-shell proc file system"
	depends on PROC_FS
	---help---
	  Choosing this option will enable you to use the MV-shell through the Proc
	  File system.
	  The MV-shell is a debug utility which can be run from the shell.

config  MV_DBG_TRACE
	bool "Enable tracing utility"
	default n
	---help---
	  Choosing this debug option will cause some kernel modules to log operations into
	  a cyclic buffer and dump them on failures. Enabling this feature decreases performance.

config  MV_REAL_TIME
	bool "Real Time softirq support"
	default n
	---help---
	  Choosing this option will give more CPU time for user space processes

config  MV_CPU_PERF_CNTRS
	bool "CPU Performance counters support"
	default n
	---help---
	  Choosing this option will enable you to use CPU Performance counters

config  MV_CPU_L2_PERF_CNTRS
	bool "CPU L2 Performance counters support"
	default n
	---help---
	  Choosing this option will enable you to use CPU L2 Performance counters


menu "SoC Networking support"
depends on MV_INCLUDE_GIG_ETH
source arch/arm/plat-orion/mv_drivers_lsp/mv_network/Kconfig
endmenu

source arch/arm/plat-orion/mv_drivers_lsp/mv_network/Kconfig
source arch/arm/plat-orion/mv_drivers_lsp/mv_cesa/Kconfig
source arch/arm/plat-orion/mv_drivers_lsp/mv_phone/Kconfig
source arch/arm/plat-orion/mv_drivers_lsp/mv_tsu/Kconfig

endmenu

endif
```

## arch/arm/plat-orion/mv_drivers_lsp/mv_cesa/Kconfig
```kconfig
menu "Cesa options"
	depends on MV_INCLUDE_CESA && !CRYPTO_DEV_MV_CESA

config  MV_CESA
	bool "Support for Marvell Cryptographic Engine and Security Acceleration"
	default y

config MV_CESA_OCF
	tristate "Support for Marvell CESA OCF driver"
	depends on MV_CESA && OCF_OCF
	---help---
	  Choosing this option will enable you to use the Marvell Cryptographic Engine and
	  Security Accelerator, under the OCF package.

config MV_CESA_TOOL
	tristate "Support for Marvell CESA Tool"
	depends on MV_CESA
	---help---

config MV_CESA_CHAIN_MODE_SUPPORT
	bool "Support CESA chain-mode"
	depends on MV_CESA
	default y
	---help---
	  Choosing this option will enable crypto engine(CESA) chain mode support.
	  Warning: currently this feature is supported only by NFP-IPSec.

config MV_CESA_TEST
	bool "Support for Marvell CESA test driver"
	depends on MV_CESA_TOOL && !MV_CESA_OCF
	---help---
	  Choosing this option will enable you to use the Marvell Cryptographic Engine and
	  Security Accelerator, with the mv_cesa_tool in test mode.

endmenu
```

## arch/arm/plat-orion/mv_drivers_lsp/mv_phone/Kconfig
```kconfig
menu "Telephony options"
	depends on MV_INCLUDE_TDM

config  MV_PHONE
	bool "Support for Marvell telephony(VoIP)"
	depends on MV_INCLUDE_TDM && PHONE
	default y
	---help---
	  Choosing this option enables the Marvell telephony underlying
	  support for various VoIP applications.
	  Note, kernel Telephony subsystem must be chosen too.

choice
	prompt "TDM Unit"
	depends on MV_PHONE
	default MV_TDM_SUPPORT_ORION

config MV_TDM_SUPPORT_ORION
	bool "Support legacy TDM(2 channels)"
	select MV_TDM_SUPPORT

config MV_COMM_UNIT_SUPPORT_ORION
	depends on ARCH_FEROCEON_KW2
	bool "Support CommUnit(up to 32 channels)"
	select MV_COMM_UNIT_SUPPORT

endchoice

config MV_TDM_SUPPORT
	depends on MV_TDM_SUPPORT_ORION
	bool

config MV_COMM_UNIT_SUPPORT
	depends on MV_COMM_UNIT_SUPPORT_ORION
	bool

choice
	prompt "SLIC Vendor"
	depends on MV_PHONE
	default ZARLINK_SLIC_SUPPORT_ORION

config SILABS_SLIC_SUPPORT_ORION
	bool "Support Silicon Labs devices"
	select SILABS_SLIC_SUPPORT

config ZARLINK_SLIC_SUPPORT_ORION
	bool "Support Zarlink/Legirity devices"
	select ZARLINK_SLIC_SUPPORT

endchoice

config SILABS_SLIC_SUPPORT
	depends on SILABS_SLIC_SUPPORT_ORION
	bool

config ZARLINK_SLIC_SUPPORT
	depends on ZARLINK_SLIC_SUPPORT_ORION
	bool

choice
	prompt "SLIC Device"
	depends on MV_PHONE && SILABS_SLIC_SUPPORT

config SILAB_SLIC_SI3226x
	bool "Support Silicon Labs 3226x device"

config SILAB_SLIC_SI3217x
	bool "Support Silicon Labs 3217x device"

endchoice

choice
	prompt "SLIC Device"
	depends on MV_PHONE && ZARLINK_SLIC_SUPPORT
	default ZARLINK_SLIC_VE880_ORION

config ZARLINK_SLIC_VE880_ORION
	bool "Support Zarlink VE880 SLIC family"
	select ZARLINK_SLIC_VE880

config ZARLINK_SLIC_VE792_ORION
	bool "Support Zarlink VE792 SLIC family"
	select ZARLINK_SLIC_VE792

endchoice

config ZARLINK_SLIC_VE880
	depends on ZARLINK_SLIC_VE880_ORION
	bool

config ZARLINK_SLIC_VE792
	depends on ZARLINK_SLIC_VE792_ORION
	bool

choice
	prompt "PCM Clock Frequency"
	depends on MV_PHONE
	default MV_TDM_PCM_CLK_8MHZ_ORION
	---help---
	This menu selects the PCM clock frequency generated by the TDM master.
	SLIC should be configured accordingly in order to maintain bus coherency.

config MV_TDM_PCM_CLK_8MHZ_ORION
	bool "Support 8MHz PCM clock"
	select MV_TDM_PCM_CLK_8MHZ

config MV_TDM_PCM_CLK_4MHZ_ORION
	bool "Support 4MHz PCM clock"
	select MV_TDM_PCM_CLK_4MHZ

config MV_TDM_PCM_CLK_2MHZ_ORION
	bool "Support 2MHz PCM clock"
	select MV_TDM_PCM_CLK_2MHZ

endchoice

config MV_TDM_PCM_CLK_8MHZ
	depends on MV_TDM_PCM_CLK_8MHZ_ORION
	bool

config MV_TDM_PCM_CLK_4MHZ
	depends on MV_TDM_PCM_CLK_4MHZ_ORION
	bool

config MV_TDM_PCM_CLK_2MHZ
	depends on MV_TDM_PCM_CLK_2MHZ_ORION
	bool

#choice
#	prompt "TDM Clock Source"
#	depends on MV_PHONE
#	default MV_TDM_USE_INTERNAL_PCLK_SOURCE

#config MV_TDM_USE_INTERNAL_PCLK_SOURCE
#	bool "Support PCLK internally generated"

#config MV_TDM_USE_EXTERNAL_PCLK_SOURCE
#	bool "Support PCLK from external source"

#config MV_TDM_USE_DCO
#	bool "Support PCLK from DCO enabled PLL"

#endchoice

choice
	prompt "TDM voice processing"
	depends on MV_PHONE
	default MV_TDM_DUMMY_ORION

config MV_TDM_DUMMY_ORION
	bool "Support TDM voice processing in softIRQ"
	select MV_TDM_DUMMY

config MV_PHONE_USE_IRQ_PROCESSING_ORION
	bool "Support TDM voice processing in IRQ"
	select MV_PHONE_USE_IRQ_PROCESSING

config MV_PHONE_USE_FIQ_PROCESSING_ORION
	depends on ARCH_FEROCEON_KW2
	bool "Support TDM voice processing in FIQ"
	select MV_PHONE_USE_FIQ_PROCESSING

endchoice

config MV_TDM_DUMMY
	depends on MV_TDM_DUMMY_ORION
	bool

config MV_PHONE_USE_IRQ_PROCESSING
	depends on MV_PHONE_USE_IRQ_PROCESSING_ORION
	bool

config MV_PHONE_USE_FIQ_PROCESSING
	depends on MV_PHONE_USE_FIQ_PROCESSING_ORION
	bool

config MV_PHONE_USE_SLIC_LIBS
	bool "Use binary SLIC drivers"
	depends on MV_PHONE
	default y
	---help---
	Unselect this option only if you have source code of SLIC drivers.
	If unsure, say "y"

endmenu
```

## arch/arm/plat-orion/mv_drivers_lsp/mv_tsu/Kconfig
```kconfig
menu "TSU options"
	depends on MV_INCLUDE_TS

config  MV_TSU
	bool "Support for Marvell Transport Stream Interface"
#	depends on MV_INCLUDE_TS
	default n
choice
	prompt "TSU interface type"
	depends on MV_TSU
	default TSU_PARALLEL_IF_ORION

config TSU_SERIAL_IF_ORION
	bool "Serial Interface"
	select TSU_SERIAL_IF
	---help---
	The TSU will work in serial mode (2 ports).

config TSU_PARALLEL_IF_ORION
	bool "Parallel Interface"
	select TSU_PARALLEL_IF
	---help---
	The TSU will work in parallel mode (1 port).
endchoice

config TSU_SERIAL_IF
	depends on TSU_SERIAL_IF_ORION
	bool

config TSU_PARALLEL_IF
	depends on TSU_PARALLEL_IF_ORION
	bool


choice
	prompt "TSU Core-Clock"
	depends on MV_TSU
	default TSU_CORE_CLK_83MHZ_ORION

config TSU_CORE_CLK_71MHZ_ORION
	bool "71 MHz TSU Core Clock"
	select TSU_CORE_CLK_71MHZ

config TSU_CORE_CLK_83MHZ_ORION
	bool "83 MHz TSU Core Clock"
	select TSU_CORE_CLK_83MHZ

config TSU_CORE_CLK_91MHZ_ORION
	bool "91 MHz TSU Core Clock"
	select TSU_CORE_CLK_91MHZ

config TSU_CORE_CLK_100MHZ_ORION
	bool "100 MHz TSU Core Clock"
	select TSU_CORE_CLK_100MHZ

endchoice

config TSU_CORE_CLK_71MHZ
	depends on TSU_CORE_CLK_71MHZ_ORION
	bool

config TSU_CORE_CLK_83MHZ
	depends on TSU_CORE_CLK_83MHZ_ORION
	bool

config TSU_CORE_CLK_91MHZ
	depends on TSU_CORE_CLK_91MHZ_ORION
	bool

config TSU_CORE_CLK_100MHZ
	depends on TSU_CORE_CLK_100MHZ_ORION
	bool


config  MV_TSU_PKT_SIZE
        int "TSU packet size"
        depends on MV_TSU
	default 188
	range 188, 256
        ---help---
          Define the TS packet size to be used (Same for both ports)
	  Must be >= 188 and <= 256.

config  MV_TSU_PROC
	bool "Support for TSU proc interface"
	depends on MV_TSU
	default y
        ---help---
          Support Proc-fs interface to configuring the TS control driver.

endmenu
```
